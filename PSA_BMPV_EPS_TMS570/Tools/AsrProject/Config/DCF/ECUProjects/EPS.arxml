AUTOSAR XML (schema 314)
package /DaVinci
  ecu configuration EPS: ecu-extract=EPS, ecu-sw-composition=EcuSwComposition
package /DaVinci/PKG_ECU
  ecu instance EPS: com-processing-period=0.001, diagnostic-address=0, sleep-mode-supported=false, wake-up-over-bus-supported=false
package /ECUComposition
  ecu sw composition EcuSwComposition: ecu-extract=EPS
    5 x service component prototype:
      CDD: service-component=CDD
      Dem: service-component=Dem
      NexteerLibs: service-component=NexteerLibs
      NvMProxy: service-component=NvMProxy
      WdgM: service-component=WdgM
    service connector prototype NvMProxy_PS_NvMP_NvmBlock_EOLVehCntrOffset_AbsHwPos_EOLVehCntrOffset: application-port=ECU_Composition.AbsHwPos.EOLVehCntrOffset, service-port=NvMProxy.PS_NvMP_NvmBlock_EOLVehCntrOffset
    service connector prototype NexteerLibs_SystemTime_ActivePull_SystemTime: application-port=ECU_Composition.ActivePull.SystemTime, service-port=NexteerLibs.SystemTime
    service connector prototype NvMProxy_PS_NvMP_NvmBlock_SteerAsstDefeat_AstLmt_SteeringAsstDefeat: application-port=ECU_Composition.AstLmt.SteeringAsstDefeat, service-port=NvMProxy.PS_NvMP_NvmBlock_SteerAsstDefeat
    service connector prototype NvMProxy_PS_NvMP_NvmBlock_AvgFricLrnData_AvgFricLrn_AvgFricLrnData: application-port=ECU_Composition.AvgFricLrn.AvgFricLrnData, service-port=NvMProxy.PS_NvMP_NvmBlock_AvgFricLrnData
    service connector prototype NexteerLibs_SystemTime_AvgFricLrn_SystemTime: application-port=ECU_Composition.AvgFricLrn.SystemTime, service-port=NexteerLibs.SystemTime
    service connector prototype NvMProxy_PS_NvMP_NvmBlock_OvervoltageData_BatteryVoltage_OvervoltageData: application-port=ECU_Composition.BatteryVoltage.OvervoltageData, service-port=NvMProxy.PS_NvMP_NvmBlock_OvervoltageData
    service connector prototype NexteerLibs_SystemTime_BatteryVoltage_SystemTime: application-port=ECU_Composition.BatteryVoltage.SystemTime, service-port=NexteerLibs.SystemTime
    service connector prototype NexteerLibs_SystemTime_BkCpPc_SystemTime: application-port=ECU_Composition.BkCpPc.SystemTime, service-port=NexteerLibs.SystemTime
    service connector prototype NexteerLibs_SystemTime_BVDiag_SystemTime: application-port=ECU_Composition.BVDiag.SystemTime, service-port=NexteerLibs.SystemTime
    service connector prototype CDD_CDDPorts_CDDInterface6_CDDPorts: application-port=ECU_Composition.CDDInterface6.CDDPorts, service-port=CDD.CDDPorts
    service connector prototype CDD_CDDPorts_CDDInterface9_CDDPorts: application-port=ECU_Composition.CDDInterface9.CDDPorts, service-port=CDD.CDDPorts
    service connector prototype WdgM_SE012_SE_100ms_10_CP001_ChkPtAp10_100msEnd_CP_ChkPtAp10_ChkPtAp10_100msEnd_CP: application-port=ECU_Composition.ChkPtAp10.ChkPtAp10_100msEnd_CP, service-port=WdgM.SE012_SE_100ms_10_CP001_ChkPtAp10_100msEnd_CP
    service connector prototype WdgM_SE012_SE_100ms_10_CP000_ChkPtAp10_100msStart_CP_ChkPtAp10_ChkPtAp10_100msStart_CP: application-port=ECU_Composition.ChkPtAp10.ChkPtAp10_100msStart_CP, service-port=WdgM.SE012_SE_100ms_10_CP000_ChkPtAp10_100msStart_CP
    service connector prototype WdgM_SE007_SE_10ms_10a_CP001_ChkPtAp10_10msaEnd_CP_ChkPtAp10_ChkPtAp10_10msaEnd_CP: application-port=ECU_Composition.ChkPtAp10.ChkPtAp10_10msaEnd_CP, service-port=WdgM.SE007_SE_10ms_10a_CP001_ChkPtAp10_10msaEnd_CP
    service connector prototype WdgM_SE007_SE_10ms_10a_CP000_ChkPtAp10_10msaStart_CP_ChkPtAp10_ChkPtAp10_10msaStart_CP: application-port=ECU_Composition.ChkPtAp10.ChkPtAp10_10msaStart_CP, service-port=WdgM.SE007_SE_10ms_10a_CP000_ChkPtAp10_10msaStart_CP
    service connector prototype WdgM_SE009_SE_10ms_10b_CP001_ChkPtAp10_10msbEnd_CP_ChkPtAp10_ChkPtAp10_10msbEnd_CP: application-port=ECU_Composition.ChkPtAp10.ChkPtAp10_10msbEnd_CP, service-port=WdgM.SE009_SE_10ms_10b_CP001_ChkPtAp10_10msbEnd_CP
    service connector prototype WdgM_SE009_SE_10ms_10b_CP000_ChkPtAp10_10msbStart_CP_ChkPtAp10_ChkPtAp10_10msbStart_CP: application-port=ECU_Composition.ChkPtAp10.ChkPtAp10_10msbStart_CP, service-port=WdgM.SE009_SE_10ms_10b_CP000_ChkPtAp10_10msbStart_CP
    service connector prototype WdgM_SE001_SE_2ms_10_CP001_ChkPtAp10_2msEnd_CP_ChkPtAp10_ChkPtAp10_2msEnd_CP: application-port=ECU_Composition.ChkPtAp10.ChkPtAp10_2msEnd_CP, service-port=WdgM.SE001_SE_2ms_10_CP001_ChkPtAp10_2msEnd_CP
    service connector prototype WdgM_SE001_SE_2ms_10_CP000_ChkPtAp10_2msStart_CP_ChkPtAp10_ChkPtAp10_2msStart_CP: application-port=ECU_Composition.ChkPtAp10.ChkPtAp10_2msStart_CP, service-port=WdgM.SE001_SE_2ms_10_CP000_ChkPtAp10_2msStart_CP
    service connector prototype WdgM_SE005_SE_4ms_10_CP001_ChkPtAp10_4msEnd_CP_ChkPtAp10_ChkPtAp10_4msEnd_CP: application-port=ECU_Composition.ChkPtAp10.ChkPtAp10_4msEnd_CP, service-port=WdgM.SE005_SE_4ms_10_CP001_ChkPtAp10_4msEnd_CP
    service connector prototype WdgM_SE005_SE_4ms_10_CP000_ChkPtAp10_4msStart_CP_ChkPtAp10_ChkPtAp10_4msStart_CP: application-port=ECU_Composition.ChkPtAp10.ChkPtAp10_4msStart_CP, service-port=WdgM.SE005_SE_4ms_10_CP000_ChkPtAp10_4msStart_CP
    service connector prototype WdgM_SE013_SE_100ms_11_CP001_ChkPtAp11_100msEnd_CP_ChkPtAp11_ChkPtAp11_100msEnd_CP: application-port=ECU_Composition.ChkPtAp11.ChkPtAp11_100msEnd_CP, service-port=WdgM.SE013_SE_100ms_11_CP001_ChkPtAp11_100msEnd_CP
    service connector prototype WdgM_SE013_SE_100ms_11_CP000_ChkPtAp11_100msStart_CP_ChkPtAp11_ChkPtAp11_100msStart_CP: application-port=ECU_Composition.ChkPtAp11.ChkPtAp11_100msStart_CP, service-port=WdgM.SE013_SE_100ms_11_CP000_ChkPtAp11_100msStart_CP
    service connector prototype WdgM_SE010_SE_10ms_11_CP001_ChkPtAp11_10msEnd_CP_ChkPtAp11_ChkPtAp11_10msEnd_CP: application-port=ECU_Composition.ChkPtAp11.ChkPtAp11_10msEnd_CP, service-port=WdgM.SE010_SE_10ms_11_CP001_ChkPtAp11_10msEnd_CP
    service connector prototype WdgM_SE010_SE_10ms_11_CP000_ChkPtAp11_10msStart_CP_ChkPtAp11_ChkPtAp11_10msStart_CP: application-port=ECU_Composition.ChkPtAp11.ChkPtAp11_10msStart_CP, service-port=WdgM.SE010_SE_10ms_11_CP000_ChkPtAp11_10msStart_CP
    service connector prototype WdgM_SE002_SE_2ms_11_CP001_ChkPtAp11_2msEnd_CP_ChkPtAp11_ChkPtAp11_2msEnd_CP: application-port=ECU_Composition.ChkPtAp11.ChkPtAp11_2msEnd_CP, service-port=WdgM.SE002_SE_2ms_11_CP001_ChkPtAp11_2msEnd_CP
    service connector prototype WdgM_SE002_SE_2ms_11_CP000_ChkPtAp11_2msStart_CP_ChkPtAp11_ChkPtAp11_2msStart_CP: application-port=ECU_Composition.ChkPtAp11.ChkPtAp11_2msStart_CP, service-port=WdgM.SE002_SE_2ms_11_CP000_ChkPtAp11_2msStart_CP
    service connector prototype WdgM_SE014_SE_100ms_6_CP001_ChkPtAp6_100msEnd_CP_ChkPtAp6_ChkPtAp6_100msEnd_CP: application-port=ECU_Composition.ChkPtAp6.ChkPtAp6_100msEnd_CP, service-port=WdgM.SE014_SE_100ms_6_CP001_ChkPtAp6_100msEnd_CP
    service connector prototype WdgM_SE014_SE_100ms_6_CP000_ChkPtAp6_100msStart_CP_ChkPtAp6_ChkPtAp6_100msStart_CP: application-port=ECU_Composition.ChkPtAp6.ChkPtAp6_100msStart_CP, service-port=WdgM.SE014_SE_100ms_6_CP000_ChkPtAp6_100msStart_CP
    service connector prototype WdgM_SE008_SE_10ms_6_CP001_ChkPtAp6_10msEnd_CP_ChkPtAp6_ChkPtAp6_10msEnd_CP: application-port=ECU_Composition.ChkPtAp6.ChkPtAp6_10msEnd_CP, service-port=WdgM.SE008_SE_10ms_6_CP001_ChkPtAp6_10msEnd_CP
    service connector prototype WdgM_SE008_SE_10ms_6_CP000_ChkPtAp6_10msStart_CP_ChkPtAp6_ChkPtAp6_10msStart_CP: application-port=ECU_Composition.ChkPtAp6.ChkPtAp6_10msStart_CP, service-port=WdgM.SE008_SE_10ms_6_CP000_ChkPtAp6_10msStart_CP
    service connector prototype WdgM_SE003_SE_2ms_6_CP001_ChkPtAp6_2msEnd_CP_ChkPtAp6_ChkPtAp6_2msEnd_CP: application-port=ECU_Composition.ChkPtAp6.ChkPtAp6_2msEnd_CP, service-port=WdgM.SE003_SE_2ms_6_CP001_ChkPtAp6_2msEnd_CP
    service connector prototype WdgM_SE003_SE_2ms_6_CP000_ChkPtAp6_2msStart_CP_ChkPtAp6_ChkPtAp6_2msStart_CP: application-port=ECU_Composition.ChkPtAp6.ChkPtAp6_2msStart_CP, service-port=WdgM.SE003_SE_2ms_6_CP000_ChkPtAp6_2msStart_CP
    service connector prototype WdgM_SE011_SE_100ms_9_CP001_ChkPtAp9_100msEnd_CP_ChkPtAp9_ChkPtAp9_100msEnd_CP: application-port=ECU_Composition.ChkPtAp9.ChkPtAp9_100msEnd_CP, service-port=WdgM.SE011_SE_100ms_9_CP001_ChkPtAp9_100msEnd_CP
    service connector prototype WdgM_SE011_SE_100ms_9_CP000_ChkPtAp9_100msStart_CP_ChkPtAp9_ChkPtAp9_100msStart_CP: application-port=ECU_Composition.ChkPtAp9.ChkPtAp9_100msStart_CP, service-port=WdgM.SE011_SE_100ms_9_CP000_ChkPtAp9_100msStart_CP
    service connector prototype WdgM_SE006_SE_10ms_9_CP001_ChkPtAp9_10msEnd_CP_ChkPtAp9_ChkPtAp9_10msEnd_CP: application-port=ECU_Composition.ChkPtAp9.ChkPtAp9_10msEnd_CP, service-port=WdgM.SE006_SE_10ms_9_CP001_ChkPtAp9_10msEnd_CP
    service connector prototype WdgM_SE006_SE_10ms_9_CP000_ChkPtAp9_10msStart_CP_ChkPtAp9_ChkPtAp9_10msStart_CP: application-port=ECU_Composition.ChkPtAp9.ChkPtAp9_10msStart_CP, service-port=WdgM.SE006_SE_10ms_9_CP000_ChkPtAp9_10msStart_CP
    service connector prototype WdgM_SE000_SE_2ms_9_CP001_ChkPtAp9_2msEnd_CP_ChkPtAp9_ChkPtAp9_2msEnd_CP: application-port=ECU_Composition.ChkPtAp9.ChkPtAp9_2msEnd_CP, service-port=WdgM.SE000_SE_2ms_9_CP001_ChkPtAp9_2msEnd_CP
    service connector prototype WdgM_SE000_SE_2ms_9_CP000_ChkPtAp9_2msStart_CP_ChkPtAp9_ChkPtAp9_2msStart_CP: application-port=ECU_Composition.ChkPtAp9.ChkPtAp9_2msStart_CP, service-port=WdgM.SE000_SE_2ms_9_CP000_ChkPtAp9_2msStart_CP
    service connector prototype WdgM_SE004_SE_4ms_9_CP001_ChkPtAp9_4msEnd_CP_ChkPtAp9_ChkPtAp9_4msEnd_CP: application-port=ECU_Composition.ChkPtAp9.ChkPtAp9_4msEnd_CP, service-port=WdgM.SE004_SE_4ms_9_CP001_ChkPtAp9_4msEnd_CP
    service connector prototype WdgM_SE004_SE_4ms_9_CP000_ChkPtAp9_4msStart_CP_ChkPtAp9_ChkPtAp9_4msStart_CP: application-port=ECU_Composition.ChkPtAp9.ChkPtAp9_4msStart_CP, service-port=WdgM.SE004_SE_4ms_9_CP000_ChkPtAp9_4msStart_CP
    service connector prototype NvMProxy_PS_NvMP_NvmBlock_CurrTempOffset_CmMtrCurr_EOLCurrTempOffset: application-port=ECU_Composition.CmMtrCurr.EOLCurrTempOffset, service-port=NvMProxy.PS_NvMP_NvmBlock_CurrTempOffset
    service connector prototype NvMProxy_PS_NvMP_NvmBlock_ShCurrCal_CmMtrCurr_EOLShCurrCal: application-port=ECU_Composition.CmMtrCurr.EOLShCurrCal, service-port=NvMProxy.PS_NvMP_NvmBlock_ShCurrCal
    service connector prototype NexteerLibs_SystemTime_ComplErr_SystemTime: application-port=ECU_Composition.ComplErr.SystemTime, service-port=NexteerLibs.SystemTime
    service connector prototype NexteerLibs_SystemTime_CtrldDisShtdn_SystemTime: application-port=ECU_Composition.CtrldDisShtdn.SystemTime, service-port=NexteerLibs.SystemTime
    service connector prototype NvMProxy_PS_NvMP_NvmBlock_EOLNomMtrParam_CurrParamComp_EOLNomMtrParamBlk: application-port=ECU_Composition.CurrParamComp.EOLNomMtrParamBlk, service-port=NvMProxy.PS_NvMP_NvmBlock_EOLNomMtrParam
    service connector prototype NexteerLibs_SystemTime_CustBattDiag_SystemTime: application-port=ECU_Composition.CustBattDiag.SystemTime, service-port=NexteerLibs.SystemTime
    service connector prototype Dem_CBDTCStatusChange_DemIf_DemIf_DTCStatusChange: application-port=ECU_Composition.DemIf.DTCStatusChange, service-port=Dem.CBDTCStatusChange_DemIf
    service connector prototype Dem_CBValByDID_0xd401_DiagSvc_CBValByDID_0xd401: application-port=ECU_Composition.DiagSvc.CBValByDID_0xd401, service-port=Dem.CBValByDID_0xd401
    service connector prototype Dem_CBValByDID_0xd{403..405}_DiagSvc_CBValByDID_0xd{403..405}: application-port=ECU_Composition.DiagSvc.CBValByDID_0xd{403..405}, service-port=Dem.CBValByDID_0xd{403..405}
    service connector prototype Dem_CBValByDID_0xd{407..409}_DiagSvc_CBValByDID_0xd{407..409}: application-port=ECU_Composition.DiagSvc.CBValByDID_0xd{407..409}, service-port=Dem.CBValByDID_0xd{407..409}
    service connector prototype Dem_CBValByDID_0xd40b_DiagSvc_CBValByDID_0xd40b: application-port=ECU_Composition.DiagSvc.CBValByDID_0xd40b, service-port=Dem.CBValByDID_0xd40b
    service connector prototype Dem_CBValByDID_0xd40c_DiagSvc_CBValByDID_0xd40c: application-port=ECU_Composition.DiagSvc.CBValByDID_0xd40c, service-port=Dem.CBValByDID_0xd40c
    service connector prototype Dem_CBValByDID_0xd40d_DiagSvc_CBValByDID_0xd40d: application-port=ECU_Composition.DiagSvc.CBValByDID_0xd40d, service-port=Dem.CBValByDID_0xd40d
    service connector prototype Dem_CBValByDID_0xd40f_DiagSvc_CBValByDID_0xd40f: application-port=ECU_Composition.DiagSvc.CBValByDID_0xd40f, service-port=Dem.CBValByDID_0xd40f
    service connector prototype Dem_CBValByDID_0xd410_DiagSvc_CBValByDID_0xd410: application-port=ECU_Composition.DiagSvc.CBValByDID_0xd410, service-port=Dem.CBValByDID_0xd410
    service connector prototype Dem_CBValByDID_0xd412_DiagSvc_CBValByDID_0xd412: application-port=ECU_Composition.DiagSvc.CBValByDID_0xd412, service-port=Dem.CBValByDID_0xd412
    service connector prototype Dem_CBValByDID_0xd414_DiagSvc_CBValByDID_0xd414: application-port=ECU_Composition.DiagSvc.CBValByDID_0xd414, service-port=Dem.CBValByDID_0xd414
    service connector prototype Dem_CBValByDID_0xd415_DiagSvc_CBValByDID_0xd415: application-port=ECU_Composition.DiagSvc.CBValByDID_0xd415, service-port=Dem.CBValByDID_0xd415
    service connector prototype Dem_CBValByDID_0xd418_DiagSvc_CBValByDID_0xd418: application-port=ECU_Composition.DiagSvc.CBValByDID_0xd418, service-port=Dem.CBValByDID_0xd418
    service connector prototype Dem_CBValByDID_0xd41b_DiagSvc_CBValByDID_0xd41b: application-port=ECU_Composition.DiagSvc.CBValByDID_0xd41b, service-port=Dem.CBValByDID_0xd41b
    service connector prototype Dem_IndStatus_ETATDA2_DiagSvc_LampStatus: application-port=ECU_Composition.DiagSvc.LampStatus, service-port=Dem.IndStatus_ETATDA2
    service connector prototype NvMProxy_PS_NvMP_NvmBlock_DigTrqTrim_DigHwTrqSENT_NvM_DigHwTrqSENTTrim_Srv: application-port=ECU_Composition.DigHwTrqSENT.NvM_DigHwTrqSENTTrim_Srv, service-port=NvMProxy.PS_NvMP_NvmBlock_DigTrqTrim
    service connector prototype Dem_CBDTCStatusChange_FaultLog_FaultLog_CallbackDTCStatusChange: application-port=ECU_Composition.FaultLog.CallbackDTCStatusChange, service-port=Dem.CBDTCStatusChange_FaultLog
    service connector prototype NexteerLibs_SystemTime_FaultLog_SystemTime: application-port=ECU_Composition.FaultLog.SystemTime, service-port=NexteerLibs.SystemTime
    service connector prototype NexteerLibs_SystemTime_FltInjection_SystemTime: application-port=ECU_Composition.FltInjection.SystemTime, service-port=NexteerLibs.SystemTime
    service connector prototype NvMProxy_PS_NvMP_NvmBlock_LearnedEOT_LrnEOT_LearnedEOTData: application-port=ECU_Composition.LrnEOT.LearnedEOTData, service-port=NvMProxy.PS_NvMP_NvmBlock_LearnedEOT
    service connector prototype NexteerLibs_SystemTime_LrnEOT_SystemTime: application-port=ECU_Composition.LrnEOT.SystemTime, service-port=NexteerLibs.SystemTime
    service connector prototype NexteerLibs_SystemTime_MtrDrvDiag_SystemTime: application-port=ECU_Composition.MtrDrvDiag.SystemTime, service-port=NexteerLibs.SystemTime
    service connector prototype NvMProxy_PS_NvMP_NvmBlock_Polarity_Polarity_Polarity: application-port=ECU_Composition.Polarity.Polarity, service-port=NvMProxy.PS_NvMP_NvmBlock_Polarity
    service connector prototype NexteerLibs_SystemTime_PwrLmtFuncCr_SystemTime: application-port=ECU_Composition.PwrLmtFuncCr.SystemTime, service-port=NexteerLibs.SystemTime
    service connector prototype NexteerLibs_SystemTime_SrlComDriver_SystemTime: application-port=ECU_Composition.SrlComDriver.SystemTime, service-port=NexteerLibs.SystemTime
    service connector prototype NvMProxy_PS_NvMP_NvmBlock_ElecIntData_SrlComInput_ElecInt: application-port=ECU_Composition.SrlComInput.ElecInt, service-port=NvMProxy.PS_NvMP_NvmBlock_ElecIntData
    service connector prototype NvMProxy_PS_NvMP_NvmBlock_ShutdownTimeData_SrlComInput_ShutdownTime: application-port=ECU_Composition.SrlComInput.ShutdownTime, service-port=NvMProxy.PS_NvMP_NvmBlock_ShutdownTimeData
    service connector prototype NexteerLibs_SystemTime_SrlComInput_SystemTime: application-port=ECU_Composition.SrlComInput.SystemTime, service-port=NexteerLibs.SystemTime
    service connector prototype NvMProxy_PS_NvMP_NvmBlock_VVHTYPEData_SrlComInput_VHHTYPE: application-port=ECU_Composition.SrlComInput.VHHTYPE, service-port=NvMProxy.PS_NvMP_NvmBlock_VVHTYPEData
    service connector prototype Dem_IndStatus_ETATDA2_SrlComOutput_IndStatusETATDA2: application-port=ECU_Composition.SrlComOutput.IndStatusETATDA2, service-port=Dem.IndStatus_ETATDA2
    service connector prototype NexteerLibs_SystemTime_SrlComOutput_SystemTime: application-port=ECU_Composition.SrlComOutput.SystemTime, service-port=NexteerLibs.SystemTime
    service connector prototype NvMProxy_PS_NvMP_NvmBlock_CloseCheckData_StaMd_CloseCheckData: application-port=ECU_Composition.StaMd.CloseCheckData, service-port=NvMProxy.PS_NvMP_NvmBlock_CloseCheckData
    service connector prototype NvMProxy_PS_NvMP_NvmBlock_TypeHRamBuffer_StaMd_TypeHData: application-port=ECU_Composition.StaMd.TypeHData, service-port=NvMProxy.PS_NvMP_NvmBlock_TypeHRamBuffer
    service connector prototype NexteerLibs_SystemTime_StOpCtrl_SystemTime: application-port=ECU_Composition.StOpCtrl.SystemTime, service-port=NexteerLibs.SystemTime
    service connector prototype NexteerLibs_SystemTime_Sweep_SystemTime: application-port=ECU_Composition.Sweep.SystemTime, service-port=NexteerLibs.SystemTime
    service connector prototype NvMProxy_PS_NvMP_NvmBlock_FltStVal_ThrmlDutyCycle_ThrmlDutyCycle_FltStVar: application-port=ECU_Composition.ThrmlDutyCycle.ThrmlDutyCycle_FltStVar, service-port=NvMProxy.PS_NvMP_NvmBlock_FltStVal
    service connector prototype NexteerLibs_SystemTime_TmprlMon_SystemTime: application-port=ECU_Composition.TmprlMon.SystemTime, service-port=NexteerLibs.SystemTime
    service connector prototype NexteerLibs_SystemTime_TmprlMon2_SystemTime: application-port=ECU_Composition.TmprlMon2.SystemTime, service-port=NexteerLibs.SystemTime
    service connector prototype NvMProxy_PS_NvMP_NvmBlock_CogTrqCal_TrqCanc_EOLCogTrqCanc: application-port=ECU_Composition.TrqCanc.EOLCogTrqCanc, service-port=NvMProxy.PS_NvMP_NvmBlock_CogTrqCal
    service connector prototype NvMProxy_PS_NvMP_NvmBlock_CogTrqRplComp_TrqCanc_EOLCogTrqRplComp: application-port=ECU_Composition.TrqCanc.EOLCogTrqRplComp, service-port=NvMProxy.PS_NvMP_NvmBlock_CogTrqRplComp
    service connector prototype NvMProxy_PS_NvMP_NvmBlock_TorqueCmdSF_TrqCmdScl_TrqCmdScl: application-port=ECU_Composition.TrqCmdScl.TrqCmdScl, service-port=NvMProxy.PS_NvMP_NvmBlock_TorqueCmdSF
    service connector prototype NvMProxy_PS_NvMP_NvmBlock_MotPosReset_VehDyn_NVM_VehDynReset_Srv: application-port=ECU_Composition.VehDyn.NVM_VehDynReset_Srv, service-port=NvMProxy.PS_NvMP_NvmBlock_MotPosReset
    service connector prototype NexteerLibs_SystemTime_VehDyn_SystemTime: application-port=ECU_Composition.VehDyn.SystemTime, service-port=NexteerLibs.SystemTime
    service connector prototype NexteerLibs_SystemTime_VehPwrMd_SystemTime: application-port=ECU_Composition.VehPwrMd.SystemTime, service-port=NexteerLibs.SystemTime
package /ECUCompositionType
  composition type ECU_Composition
    101 x component:
      AbsHwPos: type=Ap_AbsHwPos
      ActivePull: type=Ap_ActivePull
      ApXcp: type=Ap_ApXcp
      Assist: type=Ap_Assist
      AssistFirewall: type=Ap_AssistFirewall
      AstLmt: type=Ap_AstLmt
      AvgFricLrn: type=Ap_AvgFricLrn
      BatteryVoltage: type=Ap_BatteryVoltage
      BkCpPc: type=Sa_BkCpPc
      BVDiag: type=Ap_BVDiag
      CDDInterface10: type=Sa_CDDInterface10
      CDDInterface11: type=Sa_CDDInterface11
      CDDInterface6: type=Sa_CDDInterface6
      CDDInterface9: type=Sa_CDDInterface9
      ChkPtAp10: type=Ap_ChkPtAp10
      ChkPtAp11: type=Ap_ChkPtAp11
      ChkPtAp6: type=Ap_ChkPtAp6
      ChkPtAp9: type=Ap_ChkPtAp9
      CmMtrCurr: type=Sa_CmMtrCurr
      ComplErr: type=Ap_ComplErr
      CtrldDisShtdn: type=Ap_CtrldDisShtdn
      CtrlTemp: type=Sa_CtrlTemp
      CurrCmd: type=Ap_CurrCmd
      CurrParamComp: type=Ap_CurrParamComp
      CustBattDiag: type=Ap_CustBattDiag
      Damping: type=Ap_Damping
      DampingFirewall: type=Ap_DampingFirewall
      DemIf: type=Ap_DemIf
      DiagMgr10: type=Ap_DiagMgr10
      DiagMgr11: type=Ap_DiagMgr11
      DiagMgr6: type=Ap_DiagMgr6
      DiagMgr9: type=Ap_DiagMgr9
      DiagSvc: type=Ap_DiagSvc
      DigHwTrqSENT: type=Sa_DigHwTrqSENT
      DigMSB: type=Sa_DigMSB
      DigPhsReasDiag: type=Ap_DigPhsReasDiag
      ElePwr: type=Ap_ElePwr
      EOTActuatorMng: type=Ap_EOTActuatorMng
      ePWM2: type=Ap_ePWM2
      EtDmpFw: type=Ap_EtDmpFw
      FaultLog: type=Ap_FaultLog
      FltInjection: type=Ap_FltInjection
      FrqDepDmpnInrtCmp: type=Ap_FrqDepDmpnInrtCmp
      GCCDiag: type=Ap_GCCDiag
      Gsod: type=Ap_Gsod
      HighFreqAssist: type=Ap_HighFreqAssist
      HiLoadStall: type=Ap_HiLoadStall
      HwPwUp: type=Ap_HwPwUp
      HystComp: type=Ap_HystComp
      IoHwAb10: type=IoHwAb10
      IoHwAb9: type=IoHwAb9
      IoHwAbsDigSig: type=IoHwAbstraction
      LmtCod: type=Ap_LmtCod
      LrnEOT: type=Ap_LrnEOT
      MtrDrvDiag: type=Sa_MtrDrvDiag
      MtrTempEst: type=Ap_MtrTempEst
      MtrVel: type=Sa_MtrVel
      MtrVel2: type=Sa_MtrVel2
      MtrVel3: type=Sa_MtrVel3
      Nhet1: type=Cd_Nhet1
      NtWrap: type=NtWrap
      OvrVoltMon: type=Sa_OvrVoltMon
      PeakCurrEst: type=Ap_PeakCurrEst
      PICurrCntrl: type=Ap_PICurrCntrl
      Polarity: type=Ap_Polarity
      PosServo: type=Ap_PosServo
      PSASH: type=Ap_PSASH
      PSATA: type=Ap_PSATA
      PwrLmtFuncCr: type=Ap_PwrLmtFuncCr
      QuadDet: type=Ap_QuadDet
      Return: type=Ap_Return
      ReturnFirewall: type=Ap_ReturnFirewall
      RteErrata10: type=RteErrata10
      RteErrata11: type=RteErrata11
      RteErrata6: type=RteErrata6
      RteErrata9: type=RteErrata9
      ShtdnMech: type=Sa_ShtdnMech
      SignlCondn: type=Ap_SignlCondn
      SrlComDriver: type=Cd_SrlComDriver
      SrlComInput: type=Ap_SrlComInput
      SrlComOutput: type=Ap_SrlComOutput
      StabilityComp: type=Ap_StabilityComp
      StabilityComp2: type=Ap_StabilityComp2
      StaMd: type=Ap_StaMd
      StaMd11: type=Ap_StaMd11
      StaMd6: type=Ap_StaMd6
      StaMd9: type=Ap_StaMd9
      StOpCtrl: type=Ap_StOpCtrl
      Sweep: type=Ap_Sweep
      Sweep2: type=Ap_Sweep2
      ThrmlDutyCycle: type=Ap_ThrmlDutyCycle
      TmprlMon: type=Sa_TmprlMon
      TmprlMon2: type=Sa_TmprlMon2
      TqRsDg: type=Ap_TqRsDg
      TrqCanc: type=Ap_TrqCanc
      TrqCmdScl: type=Ap_TrqCmdScl
      TuningSelAuth: type=Ap_TuningSelAuth
      uDiag: type=Cd_uDiag
      VehDyn: type=Ap_VehDyn
      VehPwrMd: type=Ap_VehPwrMd
      VehSpdLmt: type=Ap_VehSpdLmt
    connect AbsHwPos.AbsHwPos_SCom -> NtWrap.C_AbsHwPos_SCom
    connect AbsHwPos.HandwheelAuthority -> ActivePull.HandwheelAuthority
    connect AbsHwPos.HandwheelAuthority -> AvgFricLrn.HwPosAuthority
    connect AbsHwPos.HandwheelAuthority -> DiagSvc.HandwheelAuthority
    connect AbsHwPos.HandwheelAuthority -> EOTActuatorMng.HandWheelAuth
    connect AbsHwPos.HandwheelAuthority -> EtDmpFw.HandwheelAuthority
    connect AbsHwPos.HandwheelAuthority -> LrnEOT.HandwheelAuthority
    connect AbsHwPos.HandwheelAuthority -> PSASH.HandwheelAuthority
    connect AbsHwPos.HandwheelAuthority -> Return.HandwheelAuthority
    connect AbsHwPos.HandwheelAuthority -> SrlComInput.HandwheelAuthority
    connect AbsHwPos.HandwheelAuthority -> SrlComOutput.HandwheelAuthority
    connect AbsHwPos.HandwheelAuthority -> VehDyn.HwAuth
    connect AbsHwPos.HandwheelAuthority -> VehSpdLmt.HwPosAuth
    connect AbsHwPos.HandwheelPosition -> ActivePull.HandwheelPosition
    connect AbsHwPos.HandwheelPosition -> AvgFricLrn.HwAng
    connect AbsHwPos.HandwheelPosition -> DiagSvc.HandwheelAngle
    connect AbsHwPos.HandwheelPosition -> EOTActuatorMng.HandWheelPos
    connect AbsHwPos.HandwheelPosition -> EtDmpFw.HandwheelPosition
    connect AbsHwPos.HandwheelPosition -> FaultLog.HandwheelPosition
    connect AbsHwPos.HandwheelPosition -> LrnEOT.HandwheelPosition
    connect AbsHwPos.HandwheelPosition -> PosServo.HandwheelPosition
    connect AbsHwPos.HandwheelPosition -> PSASH.HandwheelPosition
    connect AbsHwPos.HandwheelPosition -> Return.HandwheelPosition
    connect AbsHwPos.HandwheelPosition -> ReturnFirewall.HandwheelPosition
    connect AbsHwPos.HandwheelPosition -> SrlComOutput.HandwheelPosition
    connect AbsHwPos.HandwheelPosition -> VehDyn.HandwheelPosition
    connect AbsHwPos.HandwheelPosition -> VehSpdLmt.HwPos
    connect AbsHwPos.RelHwPos -> SrlComOutput.RelHwPos
    connect AbsHwPos.RelHwPos -> VehDyn.RelHwPos
    connect ActivePull.ActivePull_SCom -> NtWrap.C_ActivePull_SCom
    connect ActivePull.PullCompCmd -> AstLmt.PullCompCmd
    connect ApXcp.ActiveTunOvrPtrAddr -> TuningSelAuth.ActiveTunOvrPtrAddr
    connect ApXcp.TuningSessionActPtr -> TuningSelAuth.TuningSessionActPtr
    connect Assist.BaseAssistCmd -> AssistFirewall.BaseAssistCmd
    connect Assist.BaseAssistCmd -> DampingFirewall.BaseAssistCmd
    connect Assist.BaseAssistCmd -> FrqDepDmpnInrtCmp.BaseAssistCmd
    connect Assist.BaseAssistCmd -> HystComp.BaseAssistCmd
    connect AssistFirewall.AsstFirewallActive -> DampingFirewall.AsstFirewallActive
    connect AssistFirewall.AsstFirewallActive -> StabilityComp.AsstFWActive
    connect AssistFirewall.AsstFirewallActive -> StabilityComp2.AsstFWActive
    connect AssistFirewall.CombinedAssist -> StabilityComp.CombinedAssist
    connect AssistFirewall.CombinedAssist -> StabilityComp2.CombinedAssist
    connect AstLmt.AstLmt_Scom -> NtWrap.C_AstLmt_Scom
    connect AstLmt.PreLimitForStall -> HiLoadStall.PreLimitForStall
    connect AstLmt.PreLimitTorque -> EOTActuatorMng.PreLimitTorque
    connect AstLmt.SumLimTrqCmd -> Sweep2.InputMtrTrq
    connect AstLmt.TrqLimitMin -> TqRsDg.TrqLimitMin
    connect AvgFricLrn.AvgFricLrn_SCom -> NtWrap.C_AvgFricLrn_SCom
    connect AvgFricLrn.FricOffset -> HystComp.FricOffset
    connect BatteryVoltage.BatteryVoltage_SCom -> NtWrap.C_BatteryVoltage_SCom
    connect BatteryVoltage.SysC_Vecu -> Gsod.SysC_Vecu
    connect BatteryVoltage.Vecu -> CDDInterface10.Vecu
    connect BatteryVoltage.Vecu -> CmMtrCurr.Vecu
    connect BatteryVoltage.Vecu -> CurrCmd.Vecu
    connect BatteryVoltage.Vecu -> ElePwr.Vecu
    connect BatteryVoltage.Vecu -> Gsod.Vecu
    connect BatteryVoltage.Vecu -> PwrLmtFuncCr.Vecu
    connect BatteryVoltage.VswitchClosed -> MtrDrvDiag.VswitchClosed
    connect BkCpPc.CapPcDcStub -> BkCpPc.PhyCapDischarge
    connect BkCpPc.CapPcDcStub -> BkCpPc.PhyCapPrecharge
    connect BkCpPc.PwrDiscATestComplete -> HwPwUp.PwrDiscATestComplete
    connect BkCpPc.PwrDiscBTestComplete -> HwPwUp.PwrDiscBTestComplete
    connect CDDInterface11.DesiredTunSet -> ApXcp.DesiredTunSet
    connect CDDInterface11.DesiredTunSet -> TuningSelAuth.DesiredTunSet
    connect CDDInterface6.AVASelected -> SrlComOutput.AVASelected
    connect CDDInterface6.CAVHCSelected -> SrlComInput.CAVHCSelected
    connect CDDInterface6.CityParkSelected -> PSASH.ApaEna
    connect CDDInterface6.CityParkSelected -> SrlComInput.CityParkSelected
    connect CDDInterface6.CityParkSelected -> SrlComOutput.CityParkSelected
    connect CDDInterface6.DampingSrlComSvcDft -> Damping.DefeatDampingSvc
    connect CDDInterface6.DampingSrlComSvcDft -> DampingFirewall.Defeat_Damping_Svc
    connect CDDInterface6.DftAsstTbl -> Assist.DftAsstTbl
    connect CDDInterface6.DftAsstTbl -> AssistFirewall.Defeat_AsstTbl_Service
    connect CDDInterface6.DwnldAsstGain -> Assist.DwnldAsstGain
    connect CDDInterface6.EnergyModeState -> DigMSB.EnergyModeState
    connect CDDInterface6.EngONSrlComSvcDft -> VehPwrMd.EngONSrlComSvcDft
    connect CDDInterface6.EOTImpactSrlComSvcDft -> EOTActuatorMng.EOTDisable
    connect CDDInterface6.EOTImpactSrlComSvcDft -> EtDmpFw.EOTDisable
    connect CDDInterface6.EOTThermalSrlComSvcDft -> HiLoadStall.DftStallLimit
    connect CDDInterface6.FreqDepDmpSrlComSvcDft -> DampingFirewall.FreqDepDmpSrlComSvcDft
    connect CDDInterface6.FreqDepDmpSrlComSvcDft -> FrqDepDmpnInrtCmp.FreqDepDmpSrlComSvcDft
    connect CDDInterface6.FricLrnSrlComSvcDft -> AvgFricLrn.DefeatFricLearning
    connect CDDInterface6.HystCompSrlComSvcDft -> HystComp.DefeatHystService
    connect CDDInterface6.LimitSrlComSvcDft -> AstLmt.DefeatLimitService
    connect CDDInterface6.LXASelected -> SrlComDriver.LXASelected
    connect CDDInterface6.LXASelected -> SrlComInput.LXASelected
    connect CDDInterface6.MfgDiagInhibit -> DiagMgr10.MfgDiagInhibit
    connect CDDInterface6.MfgDiagInhibit -> DiagMgr11.MfgDiagInhibit
    connect CDDInterface6.MfgDiagInhibit -> DiagMgr6.MfgDiagInhibit
    connect CDDInterface6.MfgDiagInhibit -> DiagMgr9.MfgDiagInhibit
    connect CDDInterface6.PullCompSrlComSvcDft -> ActivePull.DisableLearning
    connect CDDInterface6.PullCompSrlComSvcDft -> ActivePull.DisableOutput
    connect CDDInterface6.ReturnSrlComSvcDft -> Return.DefeatReturnSvc
    connect CDDInterface6.ReturnSrlComSvcDft -> ReturnFirewall.Defeat_Return_Svc
    connect CDDInterface6.RxMsgsSrlComSvcDft -> SrlComInput.RxMsgsSrlComSvcDft
    connect CDDInterface6.SrlComSvcDft -> CmMtrCurr.SrlComSvcDft
    connect CDDInterface6.STTdSelected -> CustBattDiag.SttdSelected
    connect CDDInterface6.STTdSelected -> SrlComDriver.STTdSelected
    connect CDDInterface6.STTdSelected -> SrlComInput.STTdSelected
    connect CDDInterface6.STTdSelected -> SrlComOutput.STTdSelected
    connect CDDInterface6.STTdSelected -> VehPwrMd.STTdSelected
    connect CDDInterface6.ThermalDCSrlComSvcDft -> ThrmlDutyCycle.DefeatDutySvc
    connect CDDInterface6.TrqRmpSrlComSvcDft -> StOpCtrl.RampSrlComSvcDft
    connect CDDInterface9.ADCMtrCurr1 -> CmMtrCurr.ADCMtrCurr1
    connect CDDInterface9.ADCMtrCurr2 -> CmMtrCurr.ADCMtrCurr2
    connect CDDInterface9.CorrectedElecMtrPos -> DigMSB.CorrectedElecMtrPos
    connect CDDInterface9.CorrMtrCurrPosition -> CmMtrCurr.CorrMtrCurrPosition
    connect CDDInterface9.CorrMtrPosElec -> DigPhsReasDiag.LRPRCorrectedMtrPosCaptured
    connect CDDInterface9.CorrMtrPosElec -> Gsod.Corrected_MtrPos
    connect CDDInterface9.CorrMtrPosElec -> PICurrCntrl.CorrMtrPosElec
    connect CDDInterface9.CumMechMtrPos -> DigMSB.CumMechMtrPos
    connect CDDInterface9.Die1RxError -> DigMSB.Die1RxError
    connect CDDInterface9.Die1RxMtrPos -> DigMSB.Die1RxMtrPos
    connect CDDInterface9.Die1RxRevCtr -> DigMSB.Die1RxRevCtr
    connect CDDInterface9.Die1UnderVoltgFltAccum -> DigMSB.Die1UnderVoltgFltAccum
    connect CDDInterface9.Die2RxError -> DigMSB.Die2RxError
    connect CDDInterface9.Die2RxMtrPos -> DigMSB.Die2RxMtrPos
    connect CDDInterface9.Die2RxRevCtr -> DigMSB.Die2RxRevCtr
    connect CDDInterface9.ExpectedOnTimeA -> DigPhsReasDiag.ExpectedOnTimeA
    connect CDDInterface9.ExpectedOnTimeB -> DigPhsReasDiag.ExpectedOnTimeB
    connect CDDInterface9.ExpectedOnTimeC -> DigPhsReasDiag.ExpectedOnTimeC
    connect CDDInterface9.IgnCnt -> DiagMgr10.IgnCnt
    connect CDDInterface9.IgnCnt -> DiagMgr11.IgnCnt
    connect CDDInterface9.IgnCnt -> DiagMgr6.IgnCnt
    connect CDDInterface9.IgnCnt -> DiagMgr9.IgnCnt
    connect CDDInterface9.LRPRPhaseadvanceCaptured -> DigPhsReasDiag.LRPRPhaseadvanceCaptured
    connect CDDInterface9.MeasuredOnTimeA -> DigPhsReasDiag.MeasuredOnTimeA
    connect CDDInterface9.MeasuredOnTimeB -> DigPhsReasDiag.MeasuredOnTimeB
    connect CDDInterface9.MeasuredOnTimeC -> DigPhsReasDiag.MeasuredOnTimeC
    connect CDDInterface9.MEC -> AbsHwPos.ManufMode
    connect CDDInterface9.MEC -> AssistFirewall.MEC_Counter
    connect CDDInterface9.MEC -> CmMtrCurr.MEC
    connect CDDInterface9.MEC -> DampingFirewall.MEC_Counter
    connect CDDInterface9.MEC -> DiagMgr10.MEC
    connect CDDInterface9.MEC -> DiagMgr11.MEC
    connect CDDInterface9.MEC -> DiagMgr6.MEC
    connect CDDInterface9.MEC -> DiagMgr9.MEC
    connect CDDInterface9.MEC -> DigHwTrqSENT.MECCounter
    connect CDDInterface9.MEC -> EtDmpFw.MEC_Counter
    connect CDDInterface9.MEC -> ReturnFirewall.MEC_Counter
    connect CDDInterface9.MEC -> VehPwrMd.MEC
    connect CDDInterface9.MechMtrPos1 -> VehDyn.MechMtrPos
    connect CDDInterface9.MechMtrPos1Timestamp -> MtrVel2.MechMtrPos1Timestamp
    connect CDDInterface9.MechMtrPos2Timestamp -> MtrVel.MechMtrPos2Timestamp
    connect CDDInterface9.ModIdxFinal -> DigPhsReasDiag.LRPRModulationIndexCaptured
    connect CDDInterface9.MtrCurrDax -> ElePwr.MtrCurrDax
    connect CDDInterface9.MtrCurrDax -> PeakCurrEst.MtrCurrDax
    connect CDDInterface9.MtrCurrK1 -> CmMtrCurr.MtrCurrK1
    connect CDDInterface9.MtrCurrK2 -> CmMtrCurr.MtrCurrK2
    connect CDDInterface9.MtrCurrQax -> ElePwr.MtrCurrQax
    connect CDDInterface9.MtrCurrQax -> PeakCurrEst.MtrCurrQax
    connect CDDInterface9.MtrVoltDax -> ElePwr.MtrVoltDax
    connect CDDInterface9.MtrVoltQax -> ElePwr.MtrVoltQax
    connect CDDInterface9.RxMtrPosParityAccum -> DigMSB.RxMtrPosParityAccum
    connect CDDInterface9.SysCCorrMtrPosElec -> Gsod.SysC_Corrected_MtrPos
    connect CDDInterface9.SysCVSwitchADC -> IoHwAb10.SysCVSwitchADC
    connect CDDInterface9.UncorrMechMtrPos1 -> DigMSB.UncorrMechMtrPos1
    connect CmMtrCurr.CmMtrCurr_SCom -> NtWrap.C_CmMtrCurr_SCom
    connect CmMtrCurr.ComOffset -> CDDInterface10.CommOffset
    connect CmMtrCurr.CurrentGainSvc -> CurrCmd.CurrentGainSvc
    connect CmMtrCurr.MtrCurr1TempOffset -> CDDInterface10.MtrCurr1TempOffset
    connect CmMtrCurr.MtrCurr2TempOffset -> CDDInterface10.MtrCurr2TempOffset
    connect ComplErr.ComplErr -> AbsHwPos.ComplError
    connect CtrldDisShtdn.CntDisMtrTrqCmdCRF -> AvgFricLrn.CRFMtrTrq
    connect CtrldDisShtdn.CntDisMtrTrqCmdCRF -> ComplErr.TorqueCmdCRF
    connect CtrldDisShtdn.CntDisMtrTrqCmdCRF -> Gsod.Torque_Cmd_CRF
    connect CtrldDisShtdn.CntDisMtrTrqCmdCRF -> VehDyn.TorqueCmdCRF
    connect CtrldDisShtdn.CntDisMtrTrqCmdMRF -> DiagMgr10.MtrTrq
    connect CtrldDisShtdn.CntDisMtrTrqCmdMRF -> DiagMgr11.MtrTrq
    connect CtrldDisShtdn.CntDisMtrTrqCmdMRF -> DiagMgr6.MtrTrq
    connect CtrldDisShtdn.CntDisMtrTrqCmdMRF -> DiagMgr9.MtrTrq
    connect CtrldDisShtdn.CntDisMtrTrqCmdMRF -> Gsod.Torque_Cmd_MRF
    connect CtrldDisShtdn.CntDisMtrTrqCmdMRF -> PwrLmtFuncCr.CntDisMtrTrqCmdMRF
    connect CtrldDisShtdn.CtrldDmpStsCmp -> ePWM2.CtrldDmpStsCmp
    connect CtrldDisShtdn.CtrldDmpStsCmp -> StaMd.ControlledDampStatusComplete
    connect CtrldDisShtdn.CtrldDmpStsCmp -> StaMd11.ControlledDampStatusComplete
    connect CtrldDisShtdn.SysC_CRFMtrTrqCmd -> Gsod.SysC_Torque_Cmd_CRF
    connect CtrldDisShtdn.SysC_MRFMtrTrqCmd -> Gsod.SysC_Torque_Cmd_MRF
    connect CtrlTemp.FiltMeasTemp -> CmMtrCurr.FiltCntrlTemp
    connect CtrlTemp.FiltMeasTemp -> DiagSvc.ECUTemperature
    connect CtrlTemp.FiltMeasTemp -> FaultLog.CtrlTemp
    connect CtrlTemp.FiltMeasTemp -> MtrTempEst.CtrlTempFinal
    connect CtrlTemp.FiltMeasTemp -> ThrmlDutyCycle.FiltMeasTemp
    connect CurrCmd.MtrCurrAngle -> CmMtrCurr.MtrCurrAngle
    connect CurrCmd.MtrCurrDaxRef -> CurrParamComp.MtrCurrDaxRef
    connect CurrCmd.MtrCurrDaxRef -> PICurrCntrl.MtrCurrDaxRef
    connect CurrCmd.MtrCurrDaxRef -> TrqCanc.MtrCurrDaxRef
    connect CurrCmd.MtrCurrQaxRef -> CurrParamComp.MtrCurrQaxRef
    connect CurrCmd.MtrCurrQaxRef -> TrqCanc.MtrCurrQaxRef
    connect CurrCmd.MtrTrqCmdSign -> CDDInterface10.MtrTrqCmdSign
    connect CurrParamComp.EstKe -> CurrCmd.EstKe
    connect CurrParamComp.EstKe -> PICurrCntrl.EstKe
    connect CurrParamComp.EstKe -> PwrLmtFuncCr.EstKe
    connect CurrParamComp.EstKe -> TrqCanc.EstKe
    connect CurrParamComp.EstLd -> CurrCmd.EstLd
    connect CurrParamComp.EstLq -> CurrCmd.EstLq
    connect CurrParamComp.EstR -> CurrCmd.EstR
    connect CurrParamComp.EstR -> PICurrCntrl.EstR
    connect CurrParamComp.SCom_EOLNomMtrParam -> NtWrap.C_SCom_EOLNomMtrParam
    connect Damping.DampingCmd -> DampingFirewall.DampingCmd
    connect DampingFirewall.CombinedDamping -> AstLmt.CombinedDamping
    connect DemIf.CTCFailed -> SrlComOutput.CTCFailed
    connect DemIf.DemIf -> DiagMgr6.DemIf
    connect DiagMgr10.DiagRampRate -> StOpCtrl.DiagRampRate
    connect DiagMgr10.DiagRampValue -> StOpCtrl.DiagRampValue
    connect DiagMgr10.DiagRmpToZeroActive -> PSASH.FTermActv
    connect DiagMgr10.DiagRmpToZeroActive -> SrlComInput.DiagRmpToZeroActive
    connect DiagMgr10.DiagRmpToZeroActive -> StaMd.FTerm
    connect DiagMgr10.DiagRmpToZeroActive -> StaMd11.FTerm
    connect DiagMgr10.DiagRmpToZeroActive -> StOpCtrl.DiagStsDiagRmpActive
    connect DiagMgr10.DiagStsCtrldDisRmpPres -> CtrldDisShtdn.DiagStsF2Active
    connect DiagMgr10.DiagStsCtrldDisRmpPres -> ePWM2.DiagStsCtrldDisRmpPres
    connect DiagMgr10.DiagStsDefTemp -> CtrlTemp.DiagStsTempRdPrf
    connect DiagMgr10.DiagStsDefVehSpd -> SrlComInput.DefaultVehSpd
    connect DiagMgr10.DiagStsHWASbSystmFltPres -> AbsHwPos.DiagStatusHwPosReducedPerf
    connect DiagMgr10.DiagStsHWASbSystmFltPres -> LrnEOT.DiagStsHwPosDis
    connect DiagMgr10.DiagStsHWASbSystmFltPres -> Return.DiagStsHwPosDis
    connect DiagMgr10.DiagStsNonRecRmpToZeroFltPres -> ePWM2.DiagStsNonRecRmpToZeroFltPres
    connect DiagMgr10.DiagStsScomHWANotValid -> SrlComOutput.DefaultHwaSCommExportValue
    connect DiagMgr10.NxtrDiagMgr10 -> AbsHwPos.NxtrDiagMgr
    connect DiagMgr10.NxtrDiagMgr10 -> AssistFirewall.NxtrDiagMgr
    connect DiagMgr10.NxtrDiagMgr10 -> DampingFirewall.NxtrDiagMgr
    connect DiagMgr10.NxtrDiagMgr10 -> DigHwTrqSENT.NxtrDiagMgr
    connect DiagMgr10.NxtrDiagMgr10 -> DigMSB.NxtrDiagMgr
    connect DiagMgr10.NxtrDiagMgr10 -> DigPhsReasDiag.NxtrDiagMgr
    connect DiagMgr10.NxtrDiagMgr10 -> Gsod.NxtrDiagMgr
    connect DiagMgr10.NxtrDiagMgr10 -> IoHwAb10.NxtrDiagMgr
    connect DiagMgr10.NxtrDiagMgr10 -> MtrDrvDiag.NxtrDiagMgr
    connect DiagMgr10.NxtrDiagMgr10 -> MtrVel.NxtrDiagMgr
    connect DiagMgr10.NxtrDiagMgr10 -> OvrVoltMon.NxtrDiagMgr
    connect DiagMgr10.NxtrDiagMgr10 -> Polarity.NxtrDiagMgr
    connect DiagMgr10.NxtrDiagMgr10 -> PSATA.NxtrDiagMgr
    connect DiagMgr10.NxtrDiagMgr10 -> PwrLmtFuncCr.NxtrDiagMgr
    connect DiagMgr10.NxtrDiagMgr10 -> ReturnFirewall.NxtrDiagMgr
    connect DiagMgr10.NxtrDiagMgr10 -> SrlComInput.NxtrDiagMgr
    connect DiagMgr10.NxtrDiagMgr10 -> SrlComOutput.NxtrDiagMgr
    connect DiagMgr10.NxtrDiagMgr10 -> StabilityComp.NxtrDiagMgr
    connect DiagMgr10.NxtrDiagMgr10 -> StaMd.NxtrDiagMgr
    connect DiagMgr10.NxtrDiagMgr10 -> TqRsDg.NxtrDiagMgr
    connect DiagMgr10.NxtrDiagMgr10 -> uDiag.NxtrDiagMgr
    connect DiagMgr11.NxtrDiagMgr11 -> CmMtrCurr.NxtrDiagMgr
    connect DiagMgr11.NxtrDiagMgr11 -> CtrlTemp.NxtrDiagMgr
    connect DiagMgr11.NxtrDiagMgr11 -> MtrVel2.NxtrDiagMgr
    connect DiagMgr11.NxtrDiagMgr11 -> StaMd11.NxtrDiagMgr
    connect DiagMgr6.DiagMgr_StaCtrl -> StaMd6.DiagMgr_StaCtrl
    connect DiagMgr6.NxtrDiagMgr6 -> DiagSvc.NxtrDiagMgr
    connect DiagMgr6.NxtrDiagMgr6 -> FaultLog.NxtrDiagMgr
    connect DiagMgr6.NxtrDiagMgr6 -> SrlComDriver.NxtrDiagMgr
    connect DiagMgr9.NxtrDiagMgr9 -> AvgFricLrn.NxtrDiagMgr
    connect DiagMgr9.NxtrDiagMgr9 -> BatteryVoltage.NxtrDiagMgr
    connect DiagMgr9.NxtrDiagMgr9 -> BkCpPc.NxtrDiagMgr
    connect DiagMgr9.NxtrDiagMgr9 -> BVDiag.NxtrDiagMgr
    connect DiagMgr9.NxtrDiagMgr9 -> CustBattDiag.NxtrDiagMgr
    connect DiagMgr9.NxtrDiagMgr9 -> GCCDiag.NxtrDiagMgr
    connect DiagMgr9.NxtrDiagMgr9 -> LrnEOT.NxtrDiagMgr
    connect DiagMgr9.NxtrDiagMgr9 -> Nhet1.NxtrDiagMgr
    connect DiagMgr9.NxtrDiagMgr9 -> ThrmlDutyCycle.NxtrDiagMgr
    connect DiagMgr9.NxtrDiagMgr9 -> TmprlMon.NxtrDiagMgr
    connect DiagMgr9.NxtrDiagMgr9 -> VehDyn.NxtrDiagMgr
    connect DiagMgr9.NxtrDiagMgr9 -> VehPwrMd.NxtrDiagMgr
    connect DigHwTrqSENT.DigHwTrqSENT_SCom -> NtWrap.C_DigHwTrqSENT_SCom
    connect DigHwTrqSENT.HwTorque -> Sweep.InputHwTrq
    connect DigHwTrqSENT.SrlComHwTrq -> SrlComOutput.SrlComHwTrq
    connect DigHwTrqSENT.SrlComHwTrqValid -> DiagSvc.SrlComHwTrqValid
    connect DigHwTrqSENT.SrlComHwTrqValid -> SrlComInput.SrlComHwTrqValid
    connect DigMSB.CumMechMtrPosCRF -> AbsHwPos.AlignedCumMechMtrPosCRF
    connect DigMSB.CumMechMtrPosCRF -> AbsHwPos.CumMechMtrPosCRF
    connect DigMSB.CumMechMtrPosCRF -> MtrVel2.CumMechMtrPosMRF
    connect DigMSB.CumMechMtrPosMRF -> Gsod.Cum_Mtr_Pos_CRF
    connect DigMSB.CumMechMtrPosMRF -> QuadDet.MRFCumMtrPos
    connect DigMSB.CumMechMtrPosStatus -> AbsHwPos.TurnsCntrValidity
    connect DigMSB.MechMtrPos2 -> MtrVel.MechMtrPos2
    connect DigMSB.SysCCumMechMtrPosMRF -> Gsod.SysC_Cum_Mtr_Pos_CRF
    connect EOTActuatorMng.AssistEOTDamping -> EtDmpFw.AssistEOTDamping
    connect EOTActuatorMng.AssistEOTGain -> LmtCod.AssistEOTGain
    connect EOTActuatorMng.AssistEOTLimit -> LmtCod.AssistEOTLimit
    connect EtDmpFw.EOTDampingLtd -> AstLmt.AssistEOTDamping
    connect FltInjection.FltInjection_SCom -> Assist.FltInjection_SCom
    connect FltInjection.FltInjection_SCom -> AvgFricLrn.FltInjection_SCom
    connect FltInjection.FltInjection_SCom -> BatteryVoltage.FltInjection_SCom
    connect FltInjection.FltInjection_SCom -> Damping.FltInjection_SCom
    connect FltInjection.FltInjection_SCom -> DigHwTrqSENT.FaultInjection_SCom
    connect FltInjection.FltInjection_SCom -> EtDmpFw.FaultInjection_SCom
    connect FltInjection.FltInjection_SCom -> FrqDepDmpnInrtCmp.FltInjection_SCom
    connect FltInjection.FltInjection_SCom -> GCCDiag.FltInjection_SCom
    connect FltInjection.FltInjection_SCom -> HystComp.FltInjection_SCom
    connect FltInjection.FltInjection_SCom -> LmtCod.FltInjection_SCom
    connect FltInjection.FltInjection_SCom -> Return.FltInjection_SCom
    connect FltInjection.FltInjection_SCom -> SignlCondn.FaultInjection_SCom
    connect FltInjection.FltInjection_SCom -> StabilityComp.FaultInjection_SCom
    connect FrqDepDmpnInrtCmp.FrqDepDmpnInrtCmp -> DampingFirewall.InertiaComp
    connect HighFreqAssist.HighFreqAssist -> AssistFirewall.HighFreqAssist
    connect HiLoadStall.AssistStallLimit -> LmtCod.AssistStallLimit
    connect HiLoadStall.AssistStallLimit -> PSASH.AssistStallLimit
    connect HwPwUp.MtrDrvrInitStart -> MtrDrvDiag.MtrDrvrInitStart
    connect HwPwUp.PwrDiscATestStart -> BkCpPc.PwrDiscATestStart
    connect HwPwUp.PwrDiscBTestStart -> BkCpPc.PwrDiscBTestStart
    connect HwPwUp.PwrDiscBTestStart -> OvrVoltMon.PwrDiscBTestStart
    connect HwPwUp.TMFTestStart -> TmprlMon.TMFTestStart
    connect HystComp.HysteresisComp -> AssistFirewall.HysteresisComp
    connect IoHwAb10.Batt -> BatteryVoltage.Batt
    connect IoHwAb10.Batt -> BkCpPc.Batt
    connect IoHwAb10.Batt -> BVDiag.Batt
    connect IoHwAb10.Batt -> CustBattDiag.Batt
    connect IoHwAb10.Batt -> DiagSvc.BatteryVoltage
    connect IoHwAb10.Batt -> FaultLog.BatteryVoltage
    connect IoHwAb10.Batt -> SrlComInput.Batt
    connect IoHwAb10.BattSwitched -> BatteryVoltage.BattSwitched
    connect IoHwAb10.BattSwitched -> BkCpPc.BattSwitched
    connect IoHwAb10.SysCVSwitch -> BatteryVoltage.SysCVSwitch
    connect IoHwAb10.TemperatureADC -> CtrlTemp.TemperatureADC
    connect IoHwAb9.IoHwAb_Adc -> NtWrap.C_IoHwAb_Adc
    connect IoHwAbsDigSig.EpsEn -> CustBattDiag.EpsEn
    connect IoHwAbsDigSig.EpsEn -> DiagSvc.EpsEn
    connect IoHwAbsDigSig.EpsEn -> FaultLog.EpsEn
    connect IoHwAbsDigSig.EpsEn -> SrlComInput.EpsEn
    connect IoHwAbsDigSig.EpsEn -> SrlComOutput.EpsEn
    connect IoHwAbsDigSig.EpsEn -> VehPwrMd.EpsEn
    connect IoHwAbsDigSig.FetDrvCntl -> TmprlMon.FetDrvCntl
    connect IoHwAbsDigSig.FetDrvReset -> MtrDrvDiag.FetDrvReset
    connect IoHwAbsDigSig.FetDrvReset -> ShtdnMech.FetDrvReset
    connect IoHwAbsDigSig.FetFlt1Data -> MtrDrvDiag.FetFlt1Data
    connect IoHwAbsDigSig.FetFlt2Clk -> MtrDrvDiag.FetFlt2Clk
    connect IoHwAbsDigSig.IoHwAbPortConfig -> MtrDrvDiag.IoHwAbPortConfig
    connect IoHwAbsDigSig.OvrVoltFdbk -> OvrVoltMon.phyOvrVoltFdbk
    connect IoHwAbsDigSig.PwrSwitchEn -> TmprlMon.PwrSwitchEn
    connect IoHwAbsDigSig.SysFault2 -> ShtdnMech.SysFault2
    connect IoHwAbsDigSig.SysFault2 -> TmprlMon.SysFault2
    connect IoHwAbsDigSig.SysFault3 -> ShtdnMech.SysFault3
    connect IoHwAbsDigSig.SysFault3 -> TmprlMon.SysFault3
    connect IoHwAbsDigSig.TODReset -> StaMd.TOD
    connect IoHwAbsDigSig.WdMonitor -> TmprlMon.WdMonitor
    connect IoHwAbsDigSig.WdMonitor -> TmprlMon2.WdMonitor
    connect IoHwAbsDigSig.WdReset -> TmprlMon.WdReset
    connect LmtCod.EOTGainLtd -> AstLmt.AssistEOTGain
    connect LmtCod.EOTLimitLtd -> AstLmt.AssistEOTLimit
    connect LmtCod.OutputRampMultLtd -> AstLmt.OutputRampMult
    connect LmtCod.StallLimitLtd -> AstLmt.AssistStallLimit
    connect LmtCod.ThermalLimitLtd -> AstLmt.ThermalLimit
    connect LmtCod.VehSpdLimitLtd -> AstLmt.AssistVehSpdLimit
    connect LrnEOT.CCWFound -> EOTActuatorMng.CcwFound
    connect LrnEOT.CCWPosition -> EOTActuatorMng.CcwEOT
    connect LrnEOT.CCWPosition -> VehDyn.CcwEOT
    connect LrnEOT.CCWPosition -> VehSpdLmt.CCWPosition
    connect LrnEOT.CWFound -> EOTActuatorMng.CwFound
    connect LrnEOT.CWPosition -> EOTActuatorMng.CwEOT
    connect LrnEOT.CWPosition -> VehDyn.CwEOT
    connect LrnEOT.CWPosition -> VehSpdLmt.CWPosition
    connect LrnEOT.LrnEOT_Scom -> NtWrap.C_LrnEOT_Scom
    connect MtrDrvDiag.MtrDrvrInitComplete -> HwPwUp.MtrDrvrInitComplete
    connect MtrTempEst.AssistMechTempEst -> AvgFricLrn.Temperature
    connect MtrTempEst.AssistMechTempEst -> Damping.AssistMechTempEst
    connect MtrTempEst.AssistMechTempEst -> HystComp.AssistMechTempEst
    connect MtrTempEst.AssistMechTempEst -> Return.AssistMechTempEst
    connect MtrTempEst.CuTempEst -> CurrParamComp.CuTempEst
    connect MtrTempEst.CuTempEst -> ThrmlDutyCycle.CuTempEst
    connect MtrTempEst.MagTempEst -> CurrParamComp.MagTempEst
    connect MtrTempEst.MagTempEst -> ThrmlDutyCycle.MagTempEst
    connect MtrTempEst.SiTempEst -> CurrParamComp.SiTempEst
    connect MtrTempEst.SiTempEst -> ThrmlDutyCycle.SiTempEst
    connect MtrVel.HandwheelVel -> ActivePull.HandwheelVelocity
    connect MtrVel.HandwheelVel -> AvgFricLrn.HwVel
    connect MtrVel.HandwheelVel -> DiagSvc.HandwheelVelocity
    connect MtrVel.HandwheelVel -> MtrTempEst.HwVel
    connect MtrVel.HandwheelVel -> MtrVel2.HandwheelVel
    connect MtrVel.HandwheelVel -> Return.HandwheelVel
    connect MtrVel.HandwheelVel -> SrlComOutput.HandwheelVelocity
    connect MtrVel.MotorVelCRF -> CtrldDisShtdn.CRFMtrVel
    connect MtrVel.MotorVelCRF -> Damping.MotorVelCRF
    connect MtrVel.MotorVelCRF -> DampingFirewall.MtrVelCRF
    connect MtrVel.MotorVelCRF -> EOTActuatorMng.MotorVel
    connect MtrVel.MotorVelCRF -> EtDmpFw.CRFMtrVel
    connect MtrVel.MotorVelCRF -> FltInjection.MotorVelCRF
    connect MtrVel.MotorVelCRF -> FrqDepDmpnInrtCmp.CRFMotorVel
    connect MtrVel.MotorVelCRF -> HiLoadStall.MtrVelCRF
    connect MtrVel.MotorVelCRF -> LrnEOT.MtrVelCRF
    connect MtrVel.MotorVelCRF -> PosServo.MotorVelCRF
    connect MtrVel.MotorVelCRF -> ThrmlDutyCycle.MotorVelCRF
    connect MtrVel.MotorVelCRF -> VehDyn.MotorVelCRF
    connect MtrVel.MotorVelMRF -> BkCpPc.MotorVelocityMRFUnfiltered
    connect MtrVel.MotorVelMRF -> CDDInterface10.MRFMtrVel
    connect MtrVel.MotorVelMRF -> CmMtrCurr.MtrVel
    connect MtrVel.MotorVelMRF -> CurrCmd.MRFMtrVel
    connect MtrVel.MotorVelMRF -> DigPhsReasDiag.MotorVelMRFUnfiltered
    connect MtrVel.MotorVelMRF -> MtrVel2.MotorVelMRF
    connect MtrVel.MotorVelMRF -> PICurrCntrl.MRFMtrVel
    connect MtrVel.MotorVelMRF -> PwrLmtFuncCr.MotorVelMRF
    connect MtrVel.MotorVelMRF -> TrqCanc.MRFMtrVel
    connect MtrVel2.SysCDiagHwVel -> MtrVel.SysCDiagHwVel
    connect MtrVel2.SysCDiagMtrVelMRF -> MtrVel.SysCDiagMtrVelMRF
    connect Nhet1.DigHwTrqT1 -> DigHwTrqSENT.T1
    connect Nhet1.DigHwTrqT2 -> DigHwTrqSENT.T2
    connect NtWrap.IoHwAb_Adc -> IoHwAb10.IoHwAb_Adc
    connect NtWrap.SrlComDriver_SCom -> SrlComInput.SrlComDriver_SCom
    connect PeakCurrEst.EstPkCurr -> MtrTempEst.EstPkCurr
    connect PeakCurrEst.EstPkCurr -> ThrmlDutyCycle.MtrPkCurr
    connect PeakCurrEst.FiltEstPkCurr -> ThrmlDutyCycle.FilteredPkCurr
    connect PICurrCntrl.DervLambdaAlphaDiag -> TqRsDg.DervLambdaAlphaDiag
    connect PICurrCntrl.DervLambdaBetaDiag -> TqRsDg.DervLambdaBetaDiag
    connect Polarity.AssistAssyPolarity -> CtrldDisShtdn.AssistAssyPolarity
    connect Polarity.AssistAssyPolarity -> DigMSB.AssistAssemblyPolarity
    connect Polarity.AssistAssyPolarity -> MtrVel.AsstAssemblyPolarity
    connect Polarity.AssistAssyPolarity -> MtrVel2.AsstAssemblyPolarity
    connect Polarity.AssistAssyPolarity -> Polarity.DiagAssistAssyPolarity
    connect Polarity.AssistAssyPolarity -> VehDyn.AssistAssyPolarity
    connect Polarity.HwPosPolarity -> Polarity.DiagHwPosPolarity
    connect Polarity.HwTrqPolarity -> Polarity.DiagHwTrqPolarity
    connect Polarity.MtrElecMechPolarity -> CDDInterface6.MtrElecMechPolarity
    connect Polarity.MtrElecMechPolarity -> DigPhsReasDiag.MtrElecMechPolarity
    connect Polarity.MtrElecMechPolarity -> Gsod.MtrElecMech_Polarity
    connect Polarity.MtrElecMechPolarity -> Polarity.DiagMtrElecMechPolarity
    connect Polarity.MtrPosPolarity -> CDDInterface10.MtrPosPolarity
    connect Polarity.MtrPosPolarity -> DigMSB.MtrPosPolarity
    connect Polarity.MtrPosPolarity -> Polarity.DiagMtrPosPolarity
    connect Polarity.MtrVelPolarity -> Polarity.DiagMtrVelPolarity
    connect Polarity.Polarity_SCom -> NtWrap.C_Polarity_SCom
    connect Polarity.SysC_MtrElecMechPolarity -> Gsod.SysC_MtrElecMech_Polarity
    connect PosServo.PosSrvoCmd -> PSATA.PosSrvoCmd
    connect PosServo.PosSrvoReturnSclFct -> Return.PAReturnSclFct
    connect PSASH.APAState -> SrlComOutput.APAState
    connect PSASH.APAStateTransitionCause -> SrlComOutput.APAStateTransitionCause
    connect PSASH.PosSrvoEnable -> PosServo.PosSrvoEnable
    connect PSASH.PosSrvoEnable -> PSATA.PosSrvoEnable
    connect PSATA.OpTrqOv -> AstLmt.OpTrqOvr
    connect PSATA.PosSrvoNTC -> PSASH.PosSrvoNTC
    connect PwrLmtFuncCr.FltTrqLmt -> AstLmt.PowerLimitPerc
    connect PwrLmtFuncCr.MRFMtrTrqCmd -> DiagSvc.FinalTorqueCommand
    connect PwrLmtFuncCr.MRFMtrTrqCmd -> FaultLog.MotorTorque
    connect PwrLmtFuncCr.MRFMtrTrqCmd -> TrqCmdScl.MRFMtrTrqCmd
    connect QuadDet.MtrQuad -> CurrCmd.MtrQuad
    connect Return.ReturnCmd -> ReturnFirewall.ReturnCmd
    connect ReturnFirewall.LimitedReturn -> AstLmt.LimitedReturn
    connect SignlCondn.VehicleSpeed -> ActivePull.VehicleSpeed
    connect SignlCondn.VehicleSpeed -> Assist.VehSpd
    connect SignlCondn.VehicleSpeed -> AssistFirewall.VehicleSpeed
    connect SignlCondn.VehicleSpeed -> AstLmt.VehSpd
    connect SignlCondn.VehicleSpeed -> AvgFricLrn.VehSpd
    connect SignlCondn.VehicleSpeed -> CmMtrCurr.VehSpd
    connect SignlCondn.VehicleSpeed -> CurrCmd.VehSpd
    connect SignlCondn.VehicleSpeed -> CustBattDiag.VehicleSpeed
    connect SignlCondn.VehicleSpeed -> Damping.VehicleSpeed
    connect SignlCondn.VehicleSpeed -> DampingFirewall.VehicleSpeed
    connect SignlCondn.VehicleSpeed -> DiagMgr10.VehSpd
    connect SignlCondn.VehicleSpeed -> DiagMgr11.VehSpd
    connect SignlCondn.VehicleSpeed -> DiagMgr6.VehSpd
    connect SignlCondn.VehicleSpeed -> DiagMgr9.VehSpd
    connect SignlCondn.VehicleSpeed -> EOTActuatorMng.VehicleSpeed
    connect SignlCondn.VehicleSpeed -> EtDmpFw.Vehicle_Speed
    connect SignlCondn.VehicleSpeed -> FrqDepDmpnInrtCmp.VehicleSpeed
    connect SignlCondn.VehicleSpeed -> GCCDiag.VehicleSpeed
    connect SignlCondn.VehicleSpeed -> HighFreqAssist.VehicleSpeed
    connect SignlCondn.VehicleSpeed -> HystComp.VehicleSpeed
    connect SignlCondn.VehicleSpeed -> LmtCod.VehicleSpeed
    connect SignlCondn.VehicleSpeed -> PosServo.VehicleSpeed
    connect SignlCondn.VehicleSpeed -> PSASH.VehicleSpeed
    connect SignlCondn.VehicleSpeed -> PSATA.VehicleSpeed
    connect SignlCondn.VehicleSpeed -> Return.VehicleSpeed
    connect SignlCondn.VehicleSpeed -> ReturnFirewall.VehicleSpeed
    connect SignlCondn.VehicleSpeed -> SrlComInput.VehicleSpeed
    connect SignlCondn.VehicleSpeed -> SrlComOutput.VehicleSpeed
    connect SignlCondn.VehicleSpeed -> StabilityComp.VehicleSpeed
    connect SignlCondn.VehicleSpeed -> StabilityComp2.VehicleSpeed
    connect SignlCondn.VehicleSpeed -> Sweep.VehSpd
    connect SignlCondn.VehicleSpeed -> TuningSelAuth.VehicleSpeed
    connect SignlCondn.VehicleSpeed -> VehDyn.VehicleSpeed
    connect SignlCondn.VehicleSpeed -> VehSpdLmt.VehSpd
    connect SrlComDriver.AnneeEcoule -> SrlComInput.AnneeEcoule
    connect SrlComDriver.BusOff -> SrlComInput.BusOff
    connect SrlComDriver.CompteurTemporelVehicule -> FaultLog.CompteurTemporelVehicule
    connect SrlComDriver.CompteurTemporelVehicule -> SrlComInput.CompteurTemporelVehicule
    connect SrlComDriver.ComputerRazGCT -> FaultLog.ComputerRazGCT
    connect SrlComDriver.ComputerRazGCT -> SrlComInput.ComputerRazGCT
    connect SrlComDriver.DiagIntegraElec -> SrlComInput.DiagIntegraElec
    connect SrlComDriver.DiagMuxOn -> SrlComInput.DiagMuxOn
    connect SrlComDriver.DmdDelestDA -> CustBattDiag.DmdDelestDa
    connect SrlComDriver.DmdDelestDA -> SrlComInput.DmdDelestDA
    connect SrlComDriver.DmdDelestDA -> VehPwrMd.DmdDelestDA
    connect SrlComDriver.EffacDefaultDiag -> SrlComInput.EffacDefaultDiag
    connect SrlComDriver.EtatMT -> CustBattDiag.EtatMT
    connect SrlComDriver.EtatMT -> DiagSvc.EngineState
    connect SrlComDriver.EtatMT -> FaultLog.EngineState
    connect SrlComDriver.EtatMT -> SrlComInput.EtatMT
    connect SrlComDriver.EtatMT -> SrlComOutput.EtatMT
    connect SrlComDriver.EtatMT -> VehPwrMd.EtatMT
    connect SrlComDriver.EtatPrincipSev -> FaultLog.EtatPrincipSev
    connect SrlComDriver.EtatReseauElec -> FaultLog.EtatReseauElec
    connect SrlComDriver.ISDAT4V2BSI552MsgDLCError -> SrlComInput.ISDAT4V2BSI552MsgDLCError
    connect SrlComDriver.ISDAT4V2BSI552MsgRxTime -> FaultLog.ISDAT4V2BSI552MsgRxTime
    connect SrlComDriver.ISDAT4V2BSI552MsgRxTime -> SrlComInput.ISDAT4V2BSI552MsgRxTime
    connect SrlComDriver.ISDATBSI3F2MsgDLCError -> SrlComInput.ISDATBSI3F2MsgDLCError
    connect SrlComDriver.ISDATBSI3F2MsgRxTime -> SrlComInput.ISDATBSI3F2MsgRxTime
    connect SrlComDriver.ISDATBSI412MsgDLCError -> SrlComInput.ISDATBSI412MsgDLCError
    connect SrlComDriver.ISDATBSI412MsgRxTime -> SrlComInput.ISDATBSI412MsgRxTime
    connect SrlComDriver.ISDATBSI432MsgDLCError -> SrlComInput.ISDATBSI432MsgDLCError
    connect SrlComDriver.ISDATBSI432MsgRxTime -> SrlComInput.ISDATBSI432MsgRxTime
    connect SrlComDriver.ISDATDIRAMsgTxInProgress -> SrlComInput.ISDATDIRAMsgTxInProgress
    connect SrlComDriver.ISDATDIRAMsgTxTime -> SrlComInput.ISDATDIRAMsgTxTime
    connect SrlComDriver.ISDYN2CMMMsgDLCError -> SrlComInput.ISDYN2CMMMsgDLCError
    connect SrlComDriver.ISDYN2CMMMsgRxTime -> SrlComInput.ISDYN2CMMMsgRxTime
    connect SrlComDriver.ISDYNAASMsg -> SrlComInput.ISDYNAASMsg
    connect SrlComDriver.ISDYNAASMsgDLCError -> SrlComInput.ISDYNAASMsgDLCError
    connect SrlComDriver.ISDYNAASMsgRxTime -> SrlComInput.ISDYNAASMsgRxTime
    connect SrlComDriver.ISDYNABRMsg -> SrlComInput.ISDYNABRMsg
    connect SrlComDriver.ISDYNABRMsgDLCError -> SrlComInput.ISDYNABRMsgDLCError
    connect SrlComDriver.ISDYNABRMsgRxTime -> SrlComInput.ISDYNABRMsgRxTime
    connect SrlComDriver.ISDYNCMM208MsgDLCError -> SrlComInput.ISDYNCMM208MsgDLCError
    connect SrlComDriver.ISDYNCMM208MsgRxTime -> SrlComInput.ISDYNCMM208MsgRxTime
    connect SrlComDriver.ISDYNCMM388MsgDLCError -> SrlComInput.ISDYNCMM388MsgDLCError
    connect SrlComDriver.ISDYNCMM388MsgRxTime -> SrlComInput.ISDYNCMM388MsgRxTime
    connect SrlComDriver.ISDYNDAEFirstMessageSent -> SrlComOutput.ISDYNDAEFirstMessageSent
    connect SrlComDriver.ISDYNVOLMsg -> SrlComInput.ISDYNVOLMsg
    connect SrlComDriver.ISDYNVOLMsgDLCError -> SrlComInput.ISDYNVOLMsgDLCError
    connect SrlComDriver.ISDYNVOLMsgRxTime -> SrlComInput.ISDYNVOLMsgRxTime
    connect SrlComDriver.ISINTEELECTRONBSIMsgRxTime -> SrlComInput.ISINTEELECTRONBSIMsgRxTime
    connect SrlComDriver.JourEcoule -> SrlComInput.JourEcoule
    connect SrlComDriver.Kilometrage -> DiagSvc.Mileage
    connect SrlComDriver.Kilometrage -> FaultLog.Kilometrage
    connect SrlComDriver.MarcheARBVM -> SrlComInput.MarcheARBVM
    connect SrlComDriver.ModeDiag -> SrlComInput.ModeDiag
    connect SrlComDriver.PowerSupplies -> FaultLog.PowerSupplies
    connect SrlComDriver.SecondeEcoulee -> SrlComInput.SecondeEcoulee
    connect SrlComDriver.ShuntPosition -> FaultLog.ShuntPosition
    connect SrlComDriver.SrlComDriver_SCom -> NtWrap.C_SrlComDriver_SCom
    connect SrlComDriver.TxEnabled -> FaultLog.TxEnabled
    connect SrlComDriver.VitesseVehicleBV -> SrlComInput.VitesseVehicleBV
    connect SrlComInput.AngleVolant -> VehDyn.SrlHwAg
    connect SrlComInput.APAAuthn -> PSASH.ApaAuthn
    connect SrlComInput.ApaRelaxReq -> PSASH.ApaRelaxReq
    connect SrlComInput.APARequest -> PSASH.ApaCmdReq
    connect SrlComInput.BSIDataMissing -> FaultLog.BSIDataMissing
    connect SrlComInput.CMMDataMissing -> FaultLog.CMMDataMissing
    connect SrlComInput.CPKOK -> PSASH.CpkOk
    connect SrlComInput.ElectronicIntegration -> SrlComDriver.ElectronicIntegration
    connect SrlComInput.EngOn -> CustBattDiag.EngOn
    connect SrlComInput.EngOn -> VehPwrMd.EngOn
    connect SrlComInput.IgnTimeOff -> ThrmlDutyCycle.IgnTimeOff
    connect SrlComInput.PosSrvoHwAngle -> PosServo.PosSrvoHwAngle
    connect SrlComInput.PosSrvoHwAngle -> PSASH.PosSrvoHwAngle
    connect SrlComInput.SerialComAngleValid -> VehDyn.SrlHwAgVld
    connect SrlComInput.SrlComInput_SCom -> NtWrap.C_SrlComInput_SCom
    connect SrlComInput.SrlComVehSpd -> DiagSvc.SrlComVehSpd
    connect SrlComInput.SrlComVehSpd -> FaultLog.VehicleSpeed
    connect SrlComInput.SrlComVehSpd -> SignlCondn.SrlComVehSpeed
    connect SrlComInput.SrlComVehSpd -> VehPwrMd.SrlComVehSpd
    connect SrlComInput.ValidEngineStatus -> CustBattDiag.ValidEngineStatus
    connect SrlComInput.ValidEngineStatus -> SrlComOutput.ValidEngineStatus
    connect SrlComInput.VehicleSpeedValid -> ActivePull.VehicleSpeedValid
    connect SrlComInput.VehicleSpeedValid -> AvgFricLrn.VehicleSpeedValid
    connect SrlComInput.VehicleSpeedValid -> CmMtrCurr.VhSpdValid
    connect SrlComInput.VehicleSpeedValid -> CustBattDiag.VehicleSpeedValid
    connect SrlComInput.VehicleSpeedValid -> DiagSvc.VehicleSpeedValid
    connect SrlComInput.VehicleSpeedValid -> PSASH.VehicleSpeedValid
    connect SrlComInput.VehicleSpeedValid -> SrlComOutput.VehicleSpeedValid
    connect SrlComInput.VehicleSpeedValid -> Sweep.VehSpdValid
    connect SrlComInput.VehicleSpeedValid -> VehDyn.VehicleSpeedValid
    connect SrlComInput.VehicleSpeedValid -> VehPwrMd.VehSpdValid
    connect SrlComInput.VehTimeValid -> ThrmlDutyCycle.VehTimeValid
    connect SrlComOutput.ANGLECOLONNE -> SrlComDriver.ANGLECOLONNE
    connect SrlComOutput.AUTORARRETMOTDA -> SrlComDriver.AUTORARRETMOTDA
    connect SrlComOutput.CAUSEDESACTIVCPK -> DiagSvc.CAUSEDESACTIVCPK
    connect SrlComOutput.CAUSEDESACTIVCPK -> SrlComDriver.CAUSEDESACTIVCPK
    connect SrlComOutput.CODEDEFAUT -> SrlComDriver.CODEDEFAUT
    connect SrlComOutput.CPLEVOLANT -> SrlComDriver.CPLEVOLANT
    connect SrlComOutput.CPLEVOLANTOPTMSE -> SrlComDriver.CPLEVOLANTOPTMSE
    connect SrlComOutput.DDEREDEMDA -> SrlComDriver.DDEREDEMDA
    connect SrlComOutput.ETATASSISTDA -> DiagSvc.AssistState
    connect SrlComOutput.ETATASSISTDA -> SrlComDriver.ETATASSISTDA
    connect SrlComOutput.ETATDA2004 -> SrlComDriver.ETATDA2004
    connect SrlComOutput.ETATDA2010 -> SrlComDriver.ETATDA2010
    connect SrlComOutput.ETATDADYN -> SrlComDriver.ETATDADYN
    connect SrlComOutput.ETATDAECPK -> DiagSvc.ETATDAECPK
    connect SrlComOutput.ETATDAECPK -> SrlComDriver.ETATDAECPK
    connect SrlComOutput.ETATLIGNEAPC -> SrlComDriver.ETATLIGNEAPC
    connect SrlComOutput.ETATSECUANGLECOL -> SrlComDriver.ETATSECUANGLECOL
    connect SrlComOutput.STATUSCONFABSENT -> SrlComDriver.STATUSCONFABSENT
    connect SrlComOutput.VITESSECOLONNE -> SrlComDriver.VITESSECOLONNE
    connect StabilityComp.AssistCmd -> AstLmt.AssistCmd
    connect StabilityComp.AssistCmd -> Damping.AssistCmd
    connect StabilityComp2.SysAssistCmd -> StabilityComp.SysAssistCmd_MtrNm
    connect StaMd.MilestoneRqst -> HwPwUp.MilestoneRqst
    connect StaMd.SystemState -> CDDInterface10.SystemState
    connect StaMd.SystemState -> CtrldDisShtdn.SystemState
    connect StaMd.SystemState -> DiagMgr10.SystemState
    connect StaMd.SystemState -> DiagSvc.SystemState
    connect StaMd.SystemState -> DigPhsReasDiag.SystemState
    connect StaMd.SystemState -> FrqDepDmpnInrtCmp.SystemState
    connect StaMd.SystemState -> Gsod.SystemState
    connect StaMd.SystemState -> HwPwUp.SystemState
    connect StaMd.SystemState -> MtrDrvDiag.SystemState
    connect StaMd.SystemState -> OvrVoltMon.SystemState
    connect StaMd.SystemState -> PeakCurrEst.SystemState
    connect StaMd.SystemState -> PICurrCntrl.SystemState
    connect StaMd.SystemState -> PSASH.SystemState
    connect StaMd.SystemState -> PwrLmtFuncCr.SystemState
    connect StaMd.SystemState -> RteErrata10.SystemState
    connect StaMd.SystemState -> SrlComInput.SystemState
    connect StaMd.SystemState -> SrlComOutput.SystemState
    connect StaMd.SystemState -> StaMd.CurrentSystemState
    connect StaMd.SystemState -> TqRsDg.SystemState
    connect StaMd11.SystemState11 -> CmMtrCurr.SystemState
    connect StaMd11.SystemState11 -> DiagMgr11.SystemState
    connect StaMd11.SystemState11 -> RteErrata11.SystemState
    connect StaMd6.SystemState6 -> DiagMgr6.SystemState
    connect StaMd6.SystemState6 -> FaultLog.SystemState
    connect StaMd6.SystemState6 -> RteErrata6.SystemState
    connect StaMd6.SystemState6 -> SrlComDriver.SystemState
    connect StaMd9.SystemState9 -> ActivePull.SystemState
    connect StaMd9.SystemState9 -> AvgFricLrn.SystemState
    connect StaMd9.SystemState9 -> BatteryVoltage.SystemState
    connect StaMd9.SystemState9 -> BkCpPc.SystemState
    connect StaMd9.SystemState9 -> CustBattDiag.SystemState
    connect StaMd9.SystemState9 -> DiagMgr9.SystemState
    connect StaMd9.SystemState9 -> ePWM2.SystemState
    connect StaMd9.SystemState9 -> RteErrata9.SystemState
    connect StaMd9.SystemState9 -> ThrmlDutyCycle.SystemState
    connect StaMd9.SystemState9 -> TmprlMon.SystemState
    connect StaMd9.SystemState9 -> VehDyn.SystemState
    connect StaMd9.SystemState9 -> VehPwrMd.SystemState
    connect StOpCtrl.OutputRampMult -> LmtCod.OutputRampMult
    connect StOpCtrl.OutputRampMult -> PSASH.OutputRampMult
    connect StOpCtrl.OutputRampMult -> SrlComInput.OutputRampMult
    connect StOpCtrl.OutputRampMult -> SrlComOutput.OutputRampMult
    connect StOpCtrl.OutputRampMult -> TqRsDg.OutputRampMult
    connect StOpCtrl.OutputRampMult -> VehPwrMd.OutputRampMult
    connect StOpCtrl.RampDwnStatusComplete -> ePWM2.RampDwnStatusComplete
    connect StOpCtrl.RampDwnStatusComplete -> SrlComOutput.RampDwnStatusComplete
    connect StOpCtrl.RampDwnStatusComplete -> StaMd.RampStatusComplete
    connect StOpCtrl.RampDwnStatusComplete -> StaMd11.RampStatusComplete
    connect StOpCtrl.RampDwnStatusComplete -> VehPwrMd.RampDwnStatusComplete
    connect Sweep.OutputHwTrq -> ActivePull.HwTorque
    connect Sweep.OutputHwTrq -> Assist.HwTrq
    connect Sweep.OutputHwTrq -> AssistFirewall.HwTorque
    connect Sweep.OutputHwTrq -> AvgFricLrn.HwTrq
    connect Sweep.OutputHwTrq -> Damping.HwTorque
    connect Sweep.OutputHwTrq -> DampingFirewall.HwTorque
    connect Sweep.OutputHwTrq -> DiagMgr10.HwTrq
    connect Sweep.OutputHwTrq -> DiagMgr11.HwTrq
    connect Sweep.OutputHwTrq -> DiagMgr6.HwTrq
    connect Sweep.OutputHwTrq -> DiagMgr9.HwTrq
    connect Sweep.OutputHwTrq -> DiagSvc.HandwheelTorque
    connect Sweep.OutputHwTrq -> EOTActuatorMng.HwTorque
    connect Sweep.OutputHwTrq -> FaultLog.HandwheelTorque
    connect Sweep.OutputHwTrq -> FrqDepDmpnInrtCmp.HwTorque
    connect Sweep.OutputHwTrq -> GCCDiag.HwTorque
    connect Sweep.OutputHwTrq -> HighFreqAssist.HwTorque
    connect Sweep.OutputHwTrq -> HystComp.HwTorque
    connect Sweep.OutputHwTrq -> LrnEOT.HwTorque
    connect Sweep.OutputHwTrq -> PosServo.HwTorque
    connect Sweep.OutputHwTrq -> PSASH.HwTorque
    connect Sweep.OutputHwTrq -> PSATA.HwTorque
    connect Sweep.OutputHwTrq -> Return.HwTorque
    connect Sweep.OutputHwTrq -> SrlComOutput.HandwheelTorque
    connect Sweep.OutputHwTrq -> StabilityComp.HwTorque
    connect Sweep.OutputHwTrq -> StabilityComp2.HwTorque
    connect Sweep.OutputHwTrq -> TuningSelAuth.HwTorque
    connect Sweep.OutputHwTrq -> VehDyn.HwTorque
    connect Sweep2.OutputMtrTrq -> CtrldDisShtdn.SumLimTrqCmd
    connect ThrmlDutyCycle.DutyCycleLevel -> Assist.DutyCycleLevel
    connect ThrmlDutyCycle.ThermalLimit -> LmtCod.ThermalLimit
    connect ThrmlDutyCycle.ThermLimitPerc -> AstLmt.ThermalLimitPerc
    connect ThrmlDutyCycle.ThermLimitPerc -> PSASH.ThermLimitPerc
    connect TmprlMon.TMFTestComplete -> HwPwUp.TMFTestComplete
    connect TmprlMon.TMFTestComplete -> SrlComDriver.TMFTestComplete
    connect TmprlMon.TMFTestComplete -> StaMd.TMFTestComplete
    connect TmprlMon.TMFTestComplete -> StaMd11.TMFTestComplete
    connect TrqCanc.TrqCanc_Scom -> NtWrap.C_TrqCanc_Scom
    connect TrqCmdScl.MRFMtrTrqCmdScl -> CurrCmd.MRFTrqCmdScl
    connect TrqCmdScl.MRFMtrTrqCmdScl -> GCCDiag.MRFMtrTrqCmdScl
    connect TrqCmdScl.MRFMtrTrqCmdScl -> QuadDet.MRFMtrTrqCmdScl
    connect TrqCmdScl.TrqCmdScl_SCom -> NtWrap.C_TrqCmdScl_SCom
    connect TuningSelAuth.ActiveTunPers -> ApXcp.ActiveTunPers
    connect TuningSelAuth.ActiveTunSet -> ApXcp.ActiveTunSet
    connect VehDyn.SensorlessAuthority -> AbsHwPos.SensorlessAuthority
    connect VehDyn.SensorlessHwPos -> AbsHwPos.SensorlessHwPos
    connect VehDyn.VehDyn_SCom -> NtWrap.C_VehDyn_SCom
    connect VehPwrMd.ATermActive -> StaMd.ATerm
    connect VehPwrMd.ATermActive -> StaMd11.ATerm
    connect VehPwrMd.CTermActive -> CustBattDiag.CTerm
    connect VehPwrMd.CTermActive -> SrlComInput.CTermActive
    connect VehPwrMd.CTermActive -> StaMd.CTerm
    connect VehPwrMd.CTermActive -> StaMd11.CTerm
    connect VehPwrMd.OperRampRate -> StOpCtrl.OperRampRate
    connect VehPwrMd.OperRampValue -> StOpCtrl.OperRampValue
    connect VehSpdLmt.AstVehSpdLimit -> LmtCod.AssistVehSpdLimit
package /VehicleProject
  system EPS: fibex-element=EPS
    mapping EPS_MPPNG
      sw-impl-mappings:
        101 x swc to impl mapping:
          D_761461A3_F362_4075_BDC8_F467A1B8FC29_IMPL: component-implementation=Ap_AbsHwPos_Implementation, component=ECU_Composition.AbsHwPos
          D_F2554C91_9526_45BF_9019_735A06EC18D3_IMPL: component-implementation=Ap_ActivePull_Implementation, component=ECU_Composition.ActivePull
          D_CCFDACFF_29B3_48A3_93C4_481A45400B01_IMPL: component-implementation=Ap_ApXcp_Implementation, component=ECU_Composition.ApXcp
          D_E6460CA1_8197_4AE3_8A3B_F50161C9C28F_IMPL: component-implementation=Ap_Assist_Implementation, component=ECU_Composition.Assist
          D_5382D9DE_CE03_4288_BFA6_028127B0C82E_IMPL: component-implementation=Ap_AssistFirewall_Implementation, component=ECU_Composition.AssistFirewall
          D_1E86233A_E2A3_4650_89E8_FD51CFD890CD_IMPL: component-implementation=Ap_AstLmt_Implementation, component=ECU_Composition.AstLmt
          D_D4B304B5_B613_4812_A8AF_2EE585D0960E_IMPL: component-implementation=Ap_AvgFricLrn_Implementation, component=ECU_Composition.AvgFricLrn
          D_FED6A48A_A722_4A6F_8D3C_895E8936CB24_IMPL: component-implementation=Ap_BatteryVoltage_Implementation, component=ECU_Composition.BatteryVoltage
          D_7B1B327D_6F7F_4E07_B18F_1E764C707603_IMPL: component-implementation=Sa_BkCpPc_Implementation, component=ECU_Composition.BkCpPc
          D_052654A8_D374_4DEB_900C_B1916073A3BC_IMPL: component-implementation=Ap_BVDiag_Implementation, component=ECU_Composition.BVDiag
          D_3A143103_EB35_4C25_B8DF_9380B0D4DA25_IMPL: component-implementation=Sa_CDDInterface10_Implementation, component=ECU_Composition.CDDInterface10
          D_A581B556_0ED2_49A2_B2A4_3B0CC4CE18A1_IMPL: component-implementation=Sa_CDDInterface11_Implementation, component=ECU_Composition.CDDInterface11
          D_2E593D89_0B45_4A7F_8A56_3F81686AA805_IMPL: component-implementation=Sa_CDDInterface6_Implementation, component=ECU_Composition.CDDInterface6
          D_95F7F11E_E060_4FDF_94A8_35D52892B0B1_IMPL: component-implementation=Sa_CDDInterface9_Implementation, component=ECU_Composition.CDDInterface9
          D_1E55B495_C012_4F84_B511_1CF10476ADB6_IMPL: component-implementation=Ap_ChkPtAp10_Implementation, component=ECU_Composition.ChkPtAp10
          D_152271CB_8BC3_4A77_A38C_EF514F807EF1_IMPL: component-implementation=Ap_ChkPtAp11_Implementation, component=ECU_Composition.ChkPtAp11
          D_AA325459_0D37_4279_9968_F6CAC749E16F_IMPL: component-implementation=Ap_ChkPtAp6_Implementation, component=ECU_Composition.ChkPtAp6
          D_800423A4_1827_48C0_A0B9_2F4382E0817E_IMPL: component-implementation=Ap_ChkPtAp9_Implementation, component=ECU_Composition.ChkPtAp9
          D_D38FA076_F124_465A_B58E_65127029A123_IMPL: component-implementation=Sa_CmMtrCurr_Implementation, component=ECU_Composition.CmMtrCurr
          D_503A32C3_A391_4A19_95B8_3331F33A6091_IMPL: component-implementation=Ap_ComplErr_Implementation, component=ECU_Composition.ComplErr
          D_290EB725_432C_436B_BA7D_0034F998E417_IMPL: component-implementation=Ap_CtrldDisShtdn_Implementation, component=ECU_Composition.CtrldDisShtdn
          D_7EF354D8_7D8D_4BBC_B23A_9C44BD715FB7_IMPL: component-implementation=Sa_CtrlTemp_Implementation, component=ECU_Composition.CtrlTemp
          D_108050FC_ABE8_4FD5_A016_8BD59DB52399_IMPL: component-implementation=Ap_CurrCmd_Implementation, component=ECU_Composition.CurrCmd
          D_DFBD812F_C258_47F6_9030_12F62D8B4E68_IMPL: component-implementation=Ap_CurrParamComp_Implementation, component=ECU_Composition.CurrParamComp
          D_529230E3_CD75_4F69_B5C1_44EB61B12980_IMPL: component-implementation=Ap_CustBattDiag_Implementation, component=ECU_Composition.CustBattDiag
          D_EAEEF9C9_5716_4CE0_818C_14B21C9157A0_IMPL: component-implementation=Ap_Damping_Implementation, component=ECU_Composition.Damping
          D_6A11A197_F8C6_430E_87B6_40A237051220_IMPL: component-implementation=Ap_DampingFirewall_Implementation, component=ECU_Composition.DampingFirewall
          D_E0C07457_4A58_41E6_810F_C2D9CBBB8E6A_IMPL: component-implementation=Ap_DemIf_Implementation, component=ECU_Composition.DemIf
          D_47A8557C_F277_430D_8FA9_F5576504F1AB_IMPL: component-implementation=Ap_DiagMgr10_Implementation, component=ECU_Composition.DiagMgr10
          D_F3DBBCA3_B094_409B_8C74_9320C626DD76_IMPL: component-implementation=Ap_DiagMgr11_Implementation, component=ECU_Composition.DiagMgr11
          D_C809BF09_425D_4A8E_934E_9F6DB52A1DE7_IMPL: component-implementation=Ap_DiagMgr6_Implementation, component=ECU_Composition.DiagMgr6
          D_1E1DCE08_DAAB_4651_B5F4_0FB51A0EDA5C_IMPL: component-implementation=Ap_DiagMgr9_Implementation, component=ECU_Composition.DiagMgr9
          D_029F9516_FBB0_4230_902F_D1FB2DE8085E_IMPL: component-implementation=Ap_DiagSvc_Implementation, component=ECU_Composition.DiagSvc
          D_067636A3_2BD9_4AF3_BDCC_25D0B7081285_IMPL: component-implementation=Sa_DigHwTrqSENT_Implementation, component=ECU_Composition.DigHwTrqSENT
          D_3A2337A3_8119_44C6_8EE7_121264BFCA55_IMPL: component-implementation=Sa_DigMSB_Implementation, component=ECU_Composition.DigMSB
          D_C205BAFB_3AA9_477E_9814_2DE4F72255EF_IMPL: component-implementation=Ap_DigPhsReasDiag_Implementation, component=ECU_Composition.DigPhsReasDiag
          D_C62D3F09_4745_4664_8923_1E9BE17456C3_IMPL: component-implementation=Ap_ElePwr_Implementation, component=ECU_Composition.ElePwr
          D_3CA0A6AC_6129_4611_83F0_07C29DF2502C_IMPL: component-implementation=Ap_EOTActuatorMng_Implementation, component=ECU_Composition.EOTActuatorMng
          D_327ACB80_9434_4997_9A46_C3D002680925_IMPL: component-implementation=Ap_ePWM2_Implementation, component=ECU_Composition.ePWM2
          D_633744C3_445D_43F3_BD92_AC519D54C38E_IMPL: component-implementation=Ap_EtDmpFw_Implementation, component=ECU_Composition.EtDmpFw
          D_50E114F0_6B8B_4E3C_B8D6_4BD118AB2B48_IMPL: component-implementation=Ap_FaultLog_Implementation, component=ECU_Composition.FaultLog
          D_D8A67C83_FD39_401B_9686_1F3DC5BE8A1B_IMPL: component-implementation=Ap_FltInjection_Implementation, component=ECU_Composition.FltInjection
          D_383CC23E_1010_4F4B_9496_0060DDA8FF61_IMPL: component-implementation=Ap_FrqDepDmpnInrtCmp_Implementation, component=ECU_Composition.FrqDepDmpnInrtCmp
          D_3742DA44_BBC4_47CD_A5C2_81C75449E85D_IMPL: component-implementation=Ap_GCCDiag_Implementation, component=ECU_Composition.GCCDiag
          D_871823A1_DB3F_49CD_9053_D25D34C582A9_IMPL: component-implementation=Ap_Gsod_Implementation, component=ECU_Composition.Gsod
          D_757A4F38_E72C_46AA_B0BB_ECBBB4A7D90E_IMPL: component-implementation=Ap_HighFreqAssist_Implementation, component=ECU_Composition.HighFreqAssist
          D_4110E04B_7C39_4DB5_A51F_96FA6D4EFEBE_IMPL: component-implementation=Ap_HiLoadStall_Implementation, component=ECU_Composition.HiLoadStall
          D_FFCF4302_5774_4485_9AB7_FC45EEE33C15_IMPL: component-implementation=Ap_HwPwUp_Implementation, component=ECU_Composition.HwPwUp
          D_C509755F_0592_4050_AF09_E8D40FFA0A46_IMPL: component-implementation=Ap_HystComp_Implementation, component=ECU_Composition.HystComp
          D_FE671AC9_C635_4F1F_9904_D121F2B208D0_IMPL: component-implementation=IoHwAb10_Implementation, component=ECU_Composition.IoHwAb10
          D_D4EBBDE1_FB8B_486F_81B4_C2B135C2E2F1_IMPL: component-implementation=IoHwAb9_Implementation, component=ECU_Composition.IoHwAb9
          D_1A6366E3_86A4_442C_AF86_80B4DFE92573_IMPL: component-implementation=IoHwAbstraction_Implementation, component=ECU_Composition.IoHwAbsDigSig
          D_0AA4C53B_5206_4400_9F20_2B37748D9369_IMPL: component-implementation=Ap_LmtCod_Implementation, component=ECU_Composition.LmtCod
          D_1623D264_7C09_4192_A33F_41AEF373C0EC_IMPL: component-implementation=Ap_LrnEOT_Implementation, component=ECU_Composition.LrnEOT
          D_895D4483_7836_4E68_BB63_99E37315907B_IMPL: component-implementation=Sa_MtrDrvDiag_Implementation, component=ECU_Composition.MtrDrvDiag
          D_3713E118_67F4_4CC3_8814_031EA7B45B98_IMPL: component-implementation=Ap_MtrTempEst_Implementation, component=ECU_Composition.MtrTempEst
          D_4D9B8497_B260_4C10_9AA3_7B3A00EA862C_IMPL: component-implementation=Sa_MtrVel_Implementation, component=ECU_Composition.MtrVel
          D_88E29E4E_8EC7_44B8_A453_7D8620D7F89D_IMPL: component-implementation=Sa_MtrVel2_Implementation, component=ECU_Composition.MtrVel2
          D_CDE85FFA_40C2_4E99_9CCD_707D03A70AFE_IMPL: component-implementation=Sa_MtrVel3_Implementation, component=ECU_Composition.MtrVel3
          D_B3EC67BD_460D_4B1D_AFE8_4671CA7A2228_IMPL: component-implementation=Cd_Nhet1_Implementation, component=ECU_Composition.Nhet1
          D_42B45D03_AA0A_4FF2_BF5B_6AEE9F41E6C2_IMPL: component-implementation=NtWrap_Implementation, component=ECU_Composition.NtWrap
          D_4A21063D_A3B9_49E2_908D_9F84584D5793_IMPL: component-implementation=Sa_OvrVoltMon_Implementation, component=ECU_Composition.OvrVoltMon
          D_CF4BE3F0_CB7C_4C6B_848B_2BECD75FF315_IMPL: component-implementation=Ap_PeakCurrEst_Implementation, component=ECU_Composition.PeakCurrEst
          D_BDED6DF8_CCFC_489A_8E04_F3D815CA0462_IMPL: component-implementation=Ap_PICurrCntrl_Implementation, component=ECU_Composition.PICurrCntrl
          D_1BD74555_9E84_408B_B168_5C7E74B36799_IMPL: component-implementation=Ap_Polarity_Implementation, component=ECU_Composition.Polarity
          D_468075B7_DE18_4F21_90B6_B0303B77BBF2_IMPL: component-implementation=Ap_PosServo_Implementation, component=ECU_Composition.PosServo
          D_F90BDA43_E011_45AE_B6CE_56A2273CBC9C_IMPL: component-implementation=Ap_PSASH_Implementation, component=ECU_Composition.PSASH
          D_345A6092_0D52_4A5D_B772_64AB82DAD31C_IMPL: component-implementation=Ap_PSATA_Implementation, component=ECU_Composition.PSATA
          D_9056946F_0491_436F_8AEA_A956504C1AEF_IMPL: component-implementation=Ap_PwrLmtFuncCr_Implementation, component=ECU_Composition.PwrLmtFuncCr
          D_9C5D65B9_2E8F_41CD_9FE4_19DA31D3D995_IMPL: component-implementation=Ap_QuadDet_Implementation, component=ECU_Composition.QuadDet
          D_6BFB9857_7C9B_485B_8068_165AA6CFBDE7_IMPL: component-implementation=Ap_Return_Implementation, component=ECU_Composition.Return
          D_56BE3B71_A26B_4FED_988C_08CF63FE8EA4_IMPL: component-implementation=Ap_ReturnFirewall_Implementation, component=ECU_Composition.ReturnFirewall
          D_2BE45B4B_8D7B_474C_8041_ED0C67462AB4_IMPL: component-implementation=RteErrata10_Implementation, component=ECU_Composition.RteErrata10
          D_FFEAA316_6EEE_43A1_B7C2_A04F408F344E_IMPL: component-implementation=RteErrata11_Implementation, component=ECU_Composition.RteErrata11
          D_4732379C_A608_4B9F_8B13_D1CBFAB9C92A_IMPL: component-implementation=RteErrata6_Implementation, component=ECU_Composition.RteErrata6
          D_70A2DEDF_52D5_4613_A7BA_D572E93FCCAD_IMPL: component-implementation=RteErrata9_Implementation, component=ECU_Composition.RteErrata9
          D_6515290D_DFDF_46E5_BB94_CFF0649B1699_IMPL: component-implementation=Sa_ShtdnMech_Implementation, component=ECU_Composition.ShtdnMech
          D_45CA0E8F_2186_46FF_8122_090460B07490_IMPL: component-implementation=Ap_SignlCondn_Implementation, component=ECU_Composition.SignlCondn
          D_47629146_B834_4D22_9D34_AA23AB4E454D_IMPL: component-implementation=Cd_SrlComDriver_Implementation, component=ECU_Composition.SrlComDriver
          D_2C9341C8_8E6F_48DE_A849_5D9E41C08DFD_IMPL: component-implementation=Ap_SrlComInput_Implementation, component=ECU_Composition.SrlComInput
          D_94EAD813_57EC_4AE4_B8FA_9AA91C382379_IMPL: component-implementation=Ap_SrlComOutput_Implementation, component=ECU_Composition.SrlComOutput
          D_AE64BF13_F8F0_426B_8007_3F8854A0771E_IMPL: component-implementation=Ap_StabilityComp_Implementation, component=ECU_Composition.StabilityComp
          D_FE8F97DF_7027_48AC_9A00_8D1F8DCF5794_IMPL: component-implementation=Ap_StabilityComp2_Implementation, component=ECU_Composition.StabilityComp2
          D_C13A6E7F_A51D_46BB_A9C7_9787BCE5A410_IMPL: component-implementation=Ap_StaMd_Implementation, component=ECU_Composition.StaMd
          D_415349D6_F6C6_46D3_B0F1_31FC4A075969_IMPL: component-implementation=Ap_StaMd11_Implementation, component=ECU_Composition.StaMd11
          D_8DFE88D8_970A_49E5_AB49_0F58522BBFEE_IMPL: component-implementation=Ap_StaMd6_Implementation, component=ECU_Composition.StaMd6
          D_042D33AB_44C3_4BD5_9F37_FBC991E847F6_IMPL: component-implementation=Ap_StaMd9_Implementation, component=ECU_Composition.StaMd9
          D_6C2050CC_BB77_483C_ADD9_080FBA1E0F4C_IMPL: component-implementation=Ap_StOpCtrl_Implementation, component=ECU_Composition.StOpCtrl
          D_7660B78B_DBC5_488A_878F_AC33A4FCBA8E_IMPL: component-implementation=Ap_Sweep_Implementation, component=ECU_Composition.Sweep
          D_420DBEBD_21B0_4B7F_AE21_E6451AFD3A45_IMPL: component-implementation=Ap_Sweep2_Implementation, component=ECU_Composition.Sweep2
          D_2C23074E_6BB2_4E13_87D4_FB26054A7306_IMPL: component-implementation=Ap_ThrmlDutyCycle_Implementation, component=ECU_Composition.ThrmlDutyCycle
          D_A5B88F19_B74F_43A9_A3C2_7273E943406D_IMPL: component-implementation=Sa_TmprlMon_Implementation, component=ECU_Composition.TmprlMon
          D_0F6BB113_791D_4BB4_AAD0_BBFB1BF834DA_IMPL: component-implementation=Sa_TmprlMon2_Implementation, component=ECU_Composition.TmprlMon2
          D_170C4955_4260_4F5D_81A1_FF25A1A7345F_IMPL: component-implementation=Ap_TqRsDg_Implementation, component=ECU_Composition.TqRsDg
          D_AA05EFA2_96B8_415F_9B43_8547132B10E1_IMPL: component-implementation=Ap_TrqCanc_Implementation, component=ECU_Composition.TrqCanc
          D_37C083A9_9612_4DC8_A848_248205D19CC6_IMPL: component-implementation=Ap_TrqCmdScl_Implementation, component=ECU_Composition.TrqCmdScl
          D_B71A30FC_AB6F_4B91_B206_FF7D66AFD4B1_IMPL: component-implementation=Ap_TuningSelAuth_Implementation, component=ECU_Composition.TuningSelAuth
          D_D10DAB74_2A6C_4788_9C55_0532E8E2BEA5_IMPL: component-implementation=Cd_uDiag_Implementation, component=ECU_Composition.uDiag
          D_1BDB6DB3_457D_485B_9079_07D6AC1F3477_IMPL: component-implementation=Ap_VehDyn_Implementation, component=ECU_Composition.VehDyn
          D_1D477846_8778_4067_A69D_C40AEA212AE2_IMPL: component-implementation=Ap_VehPwrMd_Implementation, component=ECU_Composition.VehPwrMd
          D_168BBF84_3A00_4D5C_89F2_95D913148582_IMPL: component-implementation=Ap_VehSpdLmt_Implementation, component=ECU_Composition.VehSpdLmt
      sw-mappings:
        101 x swc to ecu mapping, all with ecu-instance=EPS:
          D_761461A3_F362_4075_BDC8_F467A1B8FC29_: component=ECU_Composition.AbsHwPos
          D_F2554C91_9526_45BF_9019_735A06EC18D3_: component=ECU_Composition.ActivePull
          D_CCFDACFF_29B3_48A3_93C4_481A45400B01_: component=ECU_Composition.ApXcp
          D_E6460CA1_8197_4AE3_8A3B_F50161C9C28F_: component=ECU_Composition.Assist
          D_5382D9DE_CE03_4288_BFA6_028127B0C82E_: component=ECU_Composition.AssistFirewall
          D_1E86233A_E2A3_4650_89E8_FD51CFD890CD_: component=ECU_Composition.AstLmt
          D_D4B304B5_B613_4812_A8AF_2EE585D0960E_: component=ECU_Composition.AvgFricLrn
          D_FED6A48A_A722_4A6F_8D3C_895E8936CB24_: component=ECU_Composition.BatteryVoltage
          D_7B1B327D_6F7F_4E07_B18F_1E764C707603_: component=ECU_Composition.BkCpPc
          D_052654A8_D374_4DEB_900C_B1916073A3BC_: component=ECU_Composition.BVDiag
          D_3A143103_EB35_4C25_B8DF_9380B0D4DA25_: component=ECU_Composition.CDDInterface10
          D_A581B556_0ED2_49A2_B2A4_3B0CC4CE18A1_: component=ECU_Composition.CDDInterface11
          D_2E593D89_0B45_4A7F_8A56_3F81686AA805_: component=ECU_Composition.CDDInterface6
          D_95F7F11E_E060_4FDF_94A8_35D52892B0B1_: component=ECU_Composition.CDDInterface9
          D_1E55B495_C012_4F84_B511_1CF10476ADB6_: component=ECU_Composition.ChkPtAp10
          D_152271CB_8BC3_4A77_A38C_EF514F807EF1_: component=ECU_Composition.ChkPtAp11
          D_AA325459_0D37_4279_9968_F6CAC749E16F_: component=ECU_Composition.ChkPtAp6
          D_800423A4_1827_48C0_A0B9_2F4382E0817E_: component=ECU_Composition.ChkPtAp9
          D_D38FA076_F124_465A_B58E_65127029A123_: component=ECU_Composition.CmMtrCurr
          D_503A32C3_A391_4A19_95B8_3331F33A6091_: component=ECU_Composition.ComplErr
          D_290EB725_432C_436B_BA7D_0034F998E417_: component=ECU_Composition.CtrldDisShtdn
          D_7EF354D8_7D8D_4BBC_B23A_9C44BD715FB7_: component=ECU_Composition.CtrlTemp
          D_108050FC_ABE8_4FD5_A016_8BD59DB52399_: component=ECU_Composition.CurrCmd
          D_DFBD812F_C258_47F6_9030_12F62D8B4E68_: component=ECU_Composition.CurrParamComp
          D_529230E3_CD75_4F69_B5C1_44EB61B12980_: component=ECU_Composition.CustBattDiag
          D_EAEEF9C9_5716_4CE0_818C_14B21C9157A0_: component=ECU_Composition.Damping
          D_6A11A197_F8C6_430E_87B6_40A237051220_: component=ECU_Composition.DampingFirewall
          D_E0C07457_4A58_41E6_810F_C2D9CBBB8E6A_: component=ECU_Composition.DemIf
          D_47A8557C_F277_430D_8FA9_F5576504F1AB_: component=ECU_Composition.DiagMgr10
          D_F3DBBCA3_B094_409B_8C74_9320C626DD76_: component=ECU_Composition.DiagMgr11
          D_C809BF09_425D_4A8E_934E_9F6DB52A1DE7_: component=ECU_Composition.DiagMgr6
          D_1E1DCE08_DAAB_4651_B5F4_0FB51A0EDA5C_: component=ECU_Composition.DiagMgr9
          D_029F9516_FBB0_4230_902F_D1FB2DE8085E_: component=ECU_Composition.DiagSvc
          D_067636A3_2BD9_4AF3_BDCC_25D0B7081285_: component=ECU_Composition.DigHwTrqSENT
          D_3A2337A3_8119_44C6_8EE7_121264BFCA55_: component=ECU_Composition.DigMSB
          D_C205BAFB_3AA9_477E_9814_2DE4F72255EF_: component=ECU_Composition.DigPhsReasDiag
          D_C62D3F09_4745_4664_8923_1E9BE17456C3_: component=ECU_Composition.ElePwr
          D_3CA0A6AC_6129_4611_83F0_07C29DF2502C_: component=ECU_Composition.EOTActuatorMng
          D_327ACB80_9434_4997_9A46_C3D002680925_: component=ECU_Composition.ePWM2
          D_633744C3_445D_43F3_BD92_AC519D54C38E_: component=ECU_Composition.EtDmpFw
          D_50E114F0_6B8B_4E3C_B8D6_4BD118AB2B48_: component=ECU_Composition.FaultLog
          D_D8A67C83_FD39_401B_9686_1F3DC5BE8A1B_: component=ECU_Composition.FltInjection
          D_383CC23E_1010_4F4B_9496_0060DDA8FF61_: component=ECU_Composition.FrqDepDmpnInrtCmp
          D_3742DA44_BBC4_47CD_A5C2_81C75449E85D_: component=ECU_Composition.GCCDiag
          D_871823A1_DB3F_49CD_9053_D25D34C582A9_: component=ECU_Composition.Gsod
          D_757A4F38_E72C_46AA_B0BB_ECBBB4A7D90E_: component=ECU_Composition.HighFreqAssist
          D_4110E04B_7C39_4DB5_A51F_96FA6D4EFEBE_: component=ECU_Composition.HiLoadStall
          D_FFCF4302_5774_4485_9AB7_FC45EEE33C15_: component=ECU_Composition.HwPwUp
          D_C509755F_0592_4050_AF09_E8D40FFA0A46_: component=ECU_Composition.HystComp
          D_FE671AC9_C635_4F1F_9904_D121F2B208D0_: component=ECU_Composition.IoHwAb10
          D_D4EBBDE1_FB8B_486F_81B4_C2B135C2E2F1_: component=ECU_Composition.IoHwAb9
          D_1A6366E3_86A4_442C_AF86_80B4DFE92573_: component=ECU_Composition.IoHwAbsDigSig
          D_0AA4C53B_5206_4400_9F20_2B37748D9369_: component=ECU_Composition.LmtCod
          D_1623D264_7C09_4192_A33F_41AEF373C0EC_: component=ECU_Composition.LrnEOT
          D_895D4483_7836_4E68_BB63_99E37315907B_: component=ECU_Composition.MtrDrvDiag
          D_3713E118_67F4_4CC3_8814_031EA7B45B98_: component=ECU_Composition.MtrTempEst
          D_4D9B8497_B260_4C10_9AA3_7B3A00EA862C_: component=ECU_Composition.MtrVel
          D_88E29E4E_8EC7_44B8_A453_7D8620D7F89D_: component=ECU_Composition.MtrVel2
          D_CDE85FFA_40C2_4E99_9CCD_707D03A70AFE_: component=ECU_Composition.MtrVel3
          D_B3EC67BD_460D_4B1D_AFE8_4671CA7A2228_: component=ECU_Composition.Nhet1
          D_42B45D03_AA0A_4FF2_BF5B_6AEE9F41E6C2_: component=ECU_Composition.NtWrap
          D_4A21063D_A3B9_49E2_908D_9F84584D5793_: component=ECU_Composition.OvrVoltMon
          D_CF4BE3F0_CB7C_4C6B_848B_2BECD75FF315_: component=ECU_Composition.PeakCurrEst
          D_BDED6DF8_CCFC_489A_8E04_F3D815CA0462_: component=ECU_Composition.PICurrCntrl
          D_1BD74555_9E84_408B_B168_5C7E74B36799_: component=ECU_Composition.Polarity
          D_468075B7_DE18_4F21_90B6_B0303B77BBF2_: component=ECU_Composition.PosServo
          D_F90BDA43_E011_45AE_B6CE_56A2273CBC9C_: component=ECU_Composition.PSASH
          D_345A6092_0D52_4A5D_B772_64AB82DAD31C_: component=ECU_Composition.PSATA
          D_9056946F_0491_436F_8AEA_A956504C1AEF_: component=ECU_Composition.PwrLmtFuncCr
          D_9C5D65B9_2E8F_41CD_9FE4_19DA31D3D995_: component=ECU_Composition.QuadDet
          D_6BFB9857_7C9B_485B_8068_165AA6CFBDE7_: component=ECU_Composition.Return
          D_56BE3B71_A26B_4FED_988C_08CF63FE8EA4_: component=ECU_Composition.ReturnFirewall
          D_2BE45B4B_8D7B_474C_8041_ED0C67462AB4_: component=ECU_Composition.RteErrata10
          D_FFEAA316_6EEE_43A1_B7C2_A04F408F344E_: component=ECU_Composition.RteErrata11
          D_4732379C_A608_4B9F_8B13_D1CBFAB9C92A_: component=ECU_Composition.RteErrata6
          D_70A2DEDF_52D5_4613_A7BA_D572E93FCCAD_: component=ECU_Composition.RteErrata9
          D_6515290D_DFDF_46E5_BB94_CFF0649B1699_: component=ECU_Composition.ShtdnMech
          D_45CA0E8F_2186_46FF_8122_090460B07490_: component=ECU_Composition.SignlCondn
          D_47629146_B834_4D22_9D34_AA23AB4E454D_: component=ECU_Composition.SrlComDriver
          D_2C9341C8_8E6F_48DE_A849_5D9E41C08DFD_: component=ECU_Composition.SrlComInput
          D_94EAD813_57EC_4AE4_B8FA_9AA91C382379_: component=ECU_Composition.SrlComOutput
          D_AE64BF13_F8F0_426B_8007_3F8854A0771E_: component=ECU_Composition.StabilityComp
          D_FE8F97DF_7027_48AC_9A00_8D1F8DCF5794_: component=ECU_Composition.StabilityComp2
          D_C13A6E7F_A51D_46BB_A9C7_9787BCE5A410_: component=ECU_Composition.StaMd
          D_415349D6_F6C6_46D3_B0F1_31FC4A075969_: component=ECU_Composition.StaMd11
          D_8DFE88D8_970A_49E5_AB49_0F58522BBFEE_: component=ECU_Composition.StaMd6
          D_042D33AB_44C3_4BD5_9F37_FBC991E847F6_: component=ECU_Composition.StaMd9
          D_6C2050CC_BB77_483C_ADD9_080FBA1E0F4C_: component=ECU_Composition.StOpCtrl
          D_7660B78B_DBC5_488A_878F_AC33A4FCBA8E_: component=ECU_Composition.Sweep
          D_420DBEBD_21B0_4B7F_AE21_E6451AFD3A45_: component=ECU_Composition.Sweep2
          D_2C23074E_6BB2_4E13_87D4_FB26054A7306_: component=ECU_Composition.ThrmlDutyCycle
          D_A5B88F19_B74F_43A9_A3C2_7273E943406D_: component=ECU_Composition.TmprlMon
          D_0F6BB113_791D_4BB4_AAD0_BBFB1BF834DA_: component=ECU_Composition.TmprlMon2
          D_170C4955_4260_4F5D_81A1_FF25A1A7345F_: component=ECU_Composition.TqRsDg
          D_AA05EFA2_96B8_415F_9B43_8547132B10E1_: component=ECU_Composition.TrqCanc
          D_37C083A9_9612_4DC8_A848_248205D19CC6_: component=ECU_Composition.TrqCmdScl
          D_B71A30FC_AB6F_4B91_B206_FF7D66AFD4B1_: component=ECU_Composition.TuningSelAuth
          D_D10DAB74_2A6C_4788_9C55_0532E8E2BEA5_: component=ECU_Composition.uDiag
          D_1BDB6DB3_457D_485B_9079_07D6AC1F3477_: component=ECU_Composition.VehDyn
          D_1D477846_8778_4067_A69D_C40AEA212AE2_: component=ECU_Composition.VehPwrMd
          D_168BBF84_3A00_4D5C_89F2_95D913148582_: component=ECU_Composition.VehSpdLmt
    software composition ECU_Composition: software-composition=ECU_Composition

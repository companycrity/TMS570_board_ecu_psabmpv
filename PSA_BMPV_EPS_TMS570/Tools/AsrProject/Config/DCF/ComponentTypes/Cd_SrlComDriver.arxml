AUTOSAR XML (schema 314)
package /ComponentType
  complex device driver component type Cd_SrlComDriver
    52 x provide port:
      AnneeEcoule: unqueued-sender-com-spec{data-element=Cnt_u08, can-invalidate=false, init-value=D_ZERO_CNT_U8}, provided-interface=Count_Cnt_u08
      BusOff: unqueued-sender-com-spec{data-element=Cnt_lgc, can-invalidate=false, init-value=D_FALSE_CNT_LGC}, provided-interface=BoolStatusFlag_Cnt_lgc
      ColumnAngleSetpoint: unqueued-sender-com-spec{data-element=Cnt_u16, can-invalidate=false, init-value=D_ZERO_CNT_U16}, provided-interface=Count_Cnt_u16
      CompteurTemporelVehicule: unqueued-sender-com-spec{data-element=Cnt_u32, can-invalidate=false, init-value=D_ZERO_CNT_U32}, provided-interface=Count_Cnt_u32
      ComputerRazGCT: unqueued-sender-com-spec{data-element=Cnt_u08, can-invalidate=false, init-value=D_ZERO_CNT_U8}, provided-interface=Count_Cnt_u08
      DiagIntegraElec: unqueued-sender-com-spec{data-element=Cnt_u08, can-invalidate=false, init-value=D_ZERO_CNT_U8}, provided-interface=Count_Cnt_u08
      DiagMuxOn: unqueued-sender-com-spec{data-element=Cnt_u08, can-invalidate=false, init-value=D_ZERO_CNT_U8}, provided-interface=Count_Cnt_u08
      DmdDelestDA: unqueued-sender-com-spec{data-element=Cnt_u08, can-invalidate=false, init-value=D_ZERO_CNT_U8}, provided-interface=Count_Cnt_u08
      EffacDefaultDiag: unqueued-sender-com-spec{data-element=Cnt_u08, can-invalidate=false, init-value=D_ZERO_CNT_U8}, provided-interface=Count_Cnt_u08
      EtatMT: unqueued-sender-com-spec{data-element=Cnt_u08, can-invalidate=false, init-value=D_ZERO_CNT_U8}, provided-interface=Count_Cnt_u08
      EtatPrincipSev: unqueued-sender-com-spec{data-element=Cnt_u08, can-invalidate=false, init-value=D_ZERO_CNT_U8}, provided-interface=Count_Cnt_u08
      EtatReseauElec: unqueued-sender-com-spec{data-element=Cnt_u08, can-invalidate=false, init-value=D_ZERO_CNT_U8}, provided-interface=Count_Cnt_u08
      ISDAT4V2BSI552MsgDLCError: unqueued-sender-com-spec{data-element=Cnt_u08, can-invalidate=false, init-value=D_ZERO_CNT_U8}, provided-interface=Count_Cnt_u08
      ISDAT4V2BSI552MsgRxTime: unqueued-sender-com-spec{data-element=MSec_u32, can-invalidate=false, init-value=D_ZERO_CNT_U32}, provided-interface=Time_MSec_u32
      ISDATBSI3F2MsgDLCError: unqueued-sender-com-spec{data-element=Cnt_u08, can-invalidate=false, init-value=D_ZERO_CNT_U8}, provided-interface=Count_Cnt_u08
      ISDATBSI3F2MsgRxTime: unqueued-sender-com-spec{data-element=MSec_u32, can-invalidate=false, init-value=D_ZERO_CNT_U32}, provided-interface=Time_MSec_u32
      ISDATBSI412MsgDLCError: unqueued-sender-com-spec{data-element=Cnt_u08, can-invalidate=false, init-value=D_ZERO_CNT_U8}, provided-interface=Count_Cnt_u08
      ISDATBSI412MsgRxTime: unqueued-sender-com-spec{data-element=MSec_u32, can-invalidate=false, init-value=D_ZERO_CNT_U32}, provided-interface=Time_MSec_u32
      ISDATBSI432MsgDLCError: unqueued-sender-com-spec{data-element=Cnt_u08, can-invalidate=false, init-value=D_ZERO_CNT_U8}, provided-interface=Count_Cnt_u08
      ISDATBSI432MsgRxTime: unqueued-sender-com-spec{data-element=MSec_u32, can-invalidate=false, init-value=D_ZERO_CNT_U32}, provided-interface=Time_MSec_u32
      ISDATDIRAMsgTxInProgress: unqueued-sender-com-spec{data-element=Cnt_lgc, can-invalidate=false, init-value=D_FALSE_CNT_LGC}, provided-interface=BoolStatusFlag_Cnt_lgc
      ISDATDIRAMsgTxTime: unqueued-sender-com-spec{data-element=MSec_u32, can-invalidate=false, init-value=D_ZERO_CNT_U32}, provided-interface=Time_MSec_u32
      ISDYN2CMMMsgDLCError: unqueued-sender-com-spec{data-element=Cnt_u08, can-invalidate=false, init-value=D_ZERO_CNT_U8}, provided-interface=Count_Cnt_u08
      ISDYN2CMMMsgRxTime: unqueued-sender-com-spec{data-element=MSec_u32, can-invalidate=false, init-value=D_ZERO_CNT_U32}, provided-interface=Time_MSec_u32
      ISDYNAASMsg: unqueued-sender-com-spec{data-element=Cnt_u08, can-invalidate=false, init-value=T_CANMSGINIT_CNT_U08}, provided-interface=CanMsg_Cnt_u08
      ISDYNAASMsgDLCError: unqueued-sender-com-spec{data-element=Cnt_u08, can-invalidate=false, init-value=D_ZERO_CNT_U8}, provided-interface=Count_Cnt_u08
      ISDYNAASMsgRxTime: unqueued-sender-com-spec{data-element=MSec_u32, can-invalidate=false, init-value=D_ZERO_CNT_U32}, provided-interface=Time_MSec_u32
      ISDYNABRMsg: unqueued-sender-com-spec{data-element=Cnt_u08, can-invalidate=false, init-value=T_CANMSGINIT_CNT_U08}, provided-interface=CanMsg_Cnt_u08
      ISDYNABRMsgDLCError: unqueued-sender-com-spec{data-element=Cnt_u08, can-invalidate=false, init-value=D_ZERO_CNT_U8}, provided-interface=Count_Cnt_u08
      ISDYNABRMsgRxTime: unqueued-sender-com-spec{data-element=MSec_u32, can-invalidate=false, init-value=D_ZERO_CNT_U32}, provided-interface=Time_MSec_u32
      ISDYNCMM208MsgDLCError: unqueued-sender-com-spec{data-element=Cnt_u08, can-invalidate=false, init-value=D_ZERO_CNT_U8}, provided-interface=Count_Cnt_u08
      ISDYNCMM208MsgRxTime: unqueued-sender-com-spec{data-element=MSec_u32, can-invalidate=false, init-value=D_ZERO_CNT_U32}, provided-interface=Time_MSec_u32
      ISDYNCMM388MsgDLCError: unqueued-sender-com-spec{data-element=Cnt_u08, can-invalidate=false, init-value=D_ZERO_CNT_U8}, provided-interface=Count_Cnt_u08
      ISDYNCMM388MsgRxTime: unqueued-sender-com-spec{data-element=MSec_u32, can-invalidate=false, init-value=D_ZERO_CNT_U32}, provided-interface=Time_MSec_u32
      ISDYNDAEFirstMessageSent: unqueued-sender-com-spec{data-element=Cnt_lgc, can-invalidate=false, init-value=D_FALSE_CNT_LGC}, provided-interface=BoolStatusFlag_Cnt_lgc
      ISDYNVOLMsg: unqueued-sender-com-spec{data-element=Cnt_u08, can-invalidate=false, init-value=T_CANMSGINIT_CNT_U08}, provided-interface=CanMsg_Cnt_u08
      ISDYNVOLMsgDLCError: unqueued-sender-com-spec{data-element=Cnt_u08, can-invalidate=false, init-value=D_ZERO_CNT_U8}, provided-interface=Count_Cnt_u08
      ISDYNVOLMsgRxTime: unqueued-sender-com-spec{data-element=MSec_u32, can-invalidate=false, init-value=D_ZERO_CNT_U32}, provided-interface=Time_MSec_u32
      ISINTEELECTRONBSIMsgRxTime: unqueued-sender-com-spec{data-element=MSec_u32, can-invalidate=false, init-value=D_ZERO_CNT_U32}, provided-interface=Time_MSec_u32
      JourEcoule: unqueued-sender-com-spec{data-element=Cnt_u16, can-invalidate=false, init-value=D_ZERO_CNT_U16}, provided-interface=Count_Cnt_u16
      Kilometrage: unqueued-sender-com-spec{data-element=Cnt_u32, can-invalidate=false, init-value=D_ZERO_CNT_U32}, provided-interface=Count_Cnt_u32
      LKAState: unqueued-sender-com-spec{data-element=Cnt_u08, can-invalidate=false, init-value=D_ZERO_CNT_U8}, provided-interface=Count_Cnt_u08
      LKATrqFactReq: unqueued-sender-com-spec{data-element=Cnt_u08, can-invalidate=false, init-value=D_ZERO_CNT_U8}, provided-interface=Count_Cnt_u08
      LXAActivation: unqueued-sender-com-spec{data-element=Cnt_u08, can-invalidate=false, init-value=D_ZERO_CNT_U8}, provided-interface=Count_Cnt_u08
      MarcheARBVM: unqueued-sender-com-spec{data-element=Cnt_u08, can-invalidate=false, init-value=D_ZERO_CNT_U8}, provided-interface=Count_Cnt_u08
      ModeDiag: unqueued-sender-com-spec{data-element=Cnt_u08, can-invalidate=false, init-value=D_ZERO_CNT_U8}, provided-interface=Count_Cnt_u08
      PowerSupplies: unqueued-sender-com-spec{data-element=Cnt_u08, can-invalidate=false, init-value=D_ZERO_CNT_U8}, provided-interface=Count_Cnt_u08
      SecondeEcoulee: unqueued-sender-com-spec{data-element=Cnt_u32, can-invalidate=false, init-value=D_ZERO_CNT_U32}, provided-interface=Count_Cnt_u32
      ShuntPosition: unqueued-sender-com-spec{data-element=Cnt_u08, can-invalidate=false, init-value=D_ZERO_CNT_U8}, provided-interface=Count_Cnt_u08
      SrlComDriver_SCom: provided-interface=SrlComDriver_SCom
        provided-com-specs:
          operation=ElecIntStart, queue-length=1
          operation=ElecIntStop, queue-length=1
          operation=GetBusOffCounter, queue-length=1
      TxEnabled: unqueued-sender-com-spec{data-element=Cnt_lgc, can-invalidate=false, init-value=D_FALSE_CNT_LGC}, provided-interface=BoolStatusFlag_Cnt_lgc
      VitesseVehicleBV: unqueued-sender-com-spec{data-element=Cnt_u16, can-invalidate=false, init-value=D_ZERO_CNT_U16}, provided-interface=Count_Cnt_u16
    23 x require port:
      ANGLECOLONNE: unqueued-receiver-com-spec{data-element=Cnt_u16, init-value=D_ZERO_CNT_U16}, required-interface=Count_Cnt_u16
      AUTORARRETMOTDA: unqueued-receiver-com-spec{data-element=Cnt_u08, init-value=D_ZERO_CNT_U8}, required-interface=Count_Cnt_u08
      CAUSEDESACTIVCPK: unqueued-receiver-com-spec{data-element=Cnt_u08, init-value=D_ZERO_CNT_U8}, required-interface=Count_Cnt_u08
      CODEDEFAUT: unqueued-receiver-com-spec{data-element=Cnt_u08, init-value=D_ZERO_CNT_U8}, required-interface=Count_Cnt_u08
      CPLEVOLANT: unqueued-receiver-com-spec{data-element=Cnt_u08, init-value=D_ZERO_CNT_U8}, required-interface=Count_Cnt_u08
      CPLEVOLANTOPTMSE: unqueued-receiver-com-spec{data-element=Cnt_u08, init-value=D_ZERO_CNT_U8}, required-interface=Count_Cnt_u08
      DDEREDEMDA: unqueued-receiver-com-spec{data-element=Cnt_u08, init-value=D_ZERO_CNT_U8}, required-interface=Count_Cnt_u08
      ElectronicIntegration: unqueued-receiver-com-spec{data-element=Cnt_lgc, init-value=D_FALSE_CNT_LGC}, required-interface=BoolStatusFlag_Cnt_lgc
      ETATASSISTDA: unqueued-receiver-com-spec{data-element=Cnt_u08, init-value=D_ZERO_CNT_U8}, required-interface=Count_Cnt_u08
      ETATDA2004: unqueued-receiver-com-spec{data-element=Cnt_u08, init-value=D_ZERO_CNT_U8}, required-interface=Count_Cnt_u08
      ETATDA2010: unqueued-receiver-com-spec{data-element=Cnt_u08, init-value=D_ZERO_CNT_U8}, required-interface=Count_Cnt_u08
      ETATDADYN: unqueued-receiver-com-spec{data-element=Cnt_u08, init-value=D_ZERO_CNT_U8}, required-interface=Count_Cnt_u08
      ETATDAECPK: unqueued-receiver-com-spec{data-element=Cnt_u08, init-value=D_ZERO_CNT_U8}, required-interface=Count_Cnt_u08
      ETATLIGNEAPC: unqueued-receiver-com-spec{data-element=Cnt_u08, init-value=D_ZERO_CNT_U8}, required-interface=Count_Cnt_u08
      ETATSECUANGLECOL: unqueued-receiver-com-spec{data-element=Cnt_u08, init-value=D_ZERO_CNT_U8}, required-interface=Count_Cnt_u08
      LXASelected: unqueued-receiver-com-spec{data-element=Cnt_lgc, init-value=D_FALSE_CNT_LGC}, required-interface=Enable_Cnt_lgc
      NxtrDiagMgr: required-com-specs=[GetNTCActive, GetNTCFailed, GetNTCStatus, SetNTCStatus], required-interface=NxtrDiagMgr
      STATUSCONFABSENT: unqueued-receiver-com-spec{data-element=Cnt_u32, init-value=D_ZERO_CNT_U32}, required-interface=Count_Cnt_u32
      STTdSelected: unqueued-receiver-com-spec{data-element=Cnt_lgc, init-value=D_FALSE_CNT_LGC}, required-interface=Enable_Cnt_lgc
      SystemState: required-interface=SystemState
      SystemTime: required-interface=SystemTime
        required-com-specs:
          DtrmnElapsedTime_mS_u16
          DtrmnElapsedTime_mS_u32
          DtrmnElapsedTime_uS_u16
          DtrmnElapsedTime_uS_u32
          GetSystemTime_mS_u32
          GetSystemTime_uS_u32
      TMFTestComplete: unqueued-receiver-com-spec{data-element=Cnt_lgc, init-value=D_FALSE_CNT_LGC}, required-interface=BoolStatusFlag_Cnt_lgc
      VITESSECOLONNE: unqueued-receiver-com-spec{data-element=Cnt_u16, init-value=D_ZERO_CNT_U16}, required-interface=Count_Cnt_u16
  internal behavior Cd_SrlComDriver_InternalBehavior: component=Cd_SrlComDriver
    timing event SrlComDriver_Init1_InitEvent: start-on-event=SrlComDriver_Init1, period=0
    timing event TMT_SrlComDriver_Per1: start-on-event=SrlComDriver_Per1, period=0.005
    operation invoked event OIT_SrlComDriver_SCom_ElecIntStart_SrlComDriver_SCom_ElecIntStart: start-on-event=SrlComDriver_SCom_ElecIntStart, operation=SrlComDriver_SCom.ElecIntStart
    operation invoked event OIT_SrlComDriver_SCom_ElecIntStop_SrlComDriver_SCom_ElecIntStop: start-on-event=SrlComDriver_SCom_ElecIntStop, operation=SrlComDriver_SCom.ElecIntStop
    operation invoked event OIT_SrlComDriver_SCom_GetBusOffCounter_SrlComDriver_SCom_GetBusOffCounter: start-on-event=SrlComDriver_SCom_GetBusOffCounter, operation=SrlComDriver_SCom.GetBusOffCounter
    mode switch event MST_SrlComDriver_Trns1_0: start-on-event=SrlComDriver_Trns1, activation=EXIT, mode=SystemState.Mode.OFF
    mode switch event MST_SrlComDriver_Trns2_0: start-on-event=SrlComDriver_Trns2, activation=ENTRY, mode=SystemState.Mode.OFF
    port-api-options:
      enable-take-address=false, indirect-api=false, port=ANGLECOLONNE
      enable-take-address=false, indirect-api=false, port=AnneeEcoule
      enable-take-address=false, indirect-api=false, port=AUTORARRETMOTDA
      enable-take-address=false, indirect-api=false, port=BusOff
      enable-take-address=false, indirect-api=false, port=CAUSEDESACTIVCPK
      enable-take-address=false, indirect-api=false, port=CODEDEFAUT
      enable-take-address=false, indirect-api=false, port=ColumnAngleSetpoint
      enable-take-address=false, indirect-api=false, port=CompteurTemporelVehicule
      enable-take-address=false, indirect-api=false, port=ComputerRazGCT
      enable-take-address=false, indirect-api=false, port=CPLEVOLANT
      enable-take-address=false, indirect-api=false, port=CPLEVOLANTOPTMSE
      enable-take-address=false, indirect-api=false, port=DDEREDEMDA
      enable-take-address=false, indirect-api=false, port=DiagIntegraElec
      enable-take-address=false, indirect-api=false, port=DiagMuxOn
      enable-take-address=false, indirect-api=false, port=DmdDelestDA
      enable-take-address=false, indirect-api=false, port=EffacDefaultDiag
      enable-take-address=false, indirect-api=false, port=ElectronicIntegration
      enable-take-address=false, indirect-api=false, port=ETATASSISTDA
      enable-take-address=false, indirect-api=false, port=ETATDA2004
      enable-take-address=false, indirect-api=false, port=ETATDA2010
      enable-take-address=false, indirect-api=false, port=ETATDADYN
      enable-take-address=false, indirect-api=false, port=ETATDAECPK
      enable-take-address=false, indirect-api=false, port=ETATLIGNEAPC
      enable-take-address=false, indirect-api=false, port=EtatMT
      enable-take-address=false, indirect-api=false, port=EtatPrincipSev
      enable-take-address=false, indirect-api=false, port=EtatReseauElec
      enable-take-address=false, indirect-api=false, port=ETATSECUANGLECOL
      enable-take-address=false, indirect-api=false, port=ISDAT4V2BSI552MsgDLCError
      enable-take-address=false, indirect-api=false, port=ISDAT4V2BSI552MsgRxTime
      enable-take-address=false, indirect-api=false, port=ISDATBSI3F2MsgDLCError
      enable-take-address=false, indirect-api=false, port=ISDATBSI3F2MsgRxTime
      enable-take-address=false, indirect-api=false, port=ISDATBSI412MsgDLCError
      enable-take-address=false, indirect-api=false, port=ISDATBSI412MsgRxTime
      enable-take-address=false, indirect-api=false, port=ISDATBSI432MsgDLCError
      enable-take-address=false, indirect-api=false, port=ISDATBSI432MsgRxTime
      enable-take-address=false, indirect-api=false, port=ISDATDIRAMsgTxInProgress
      enable-take-address=false, indirect-api=false, port=ISDATDIRAMsgTxTime
      enable-take-address=false, indirect-api=false, port=ISDYN2CMMMsgDLCError
      enable-take-address=false, indirect-api=false, port=ISDYN2CMMMsgRxTime
      enable-take-address=false, indirect-api=false, port=ISDYNAASMsg
      enable-take-address=false, indirect-api=false, port=ISDYNAASMsgDLCError
      enable-take-address=false, indirect-api=false, port=ISDYNAASMsgRxTime
      enable-take-address=false, indirect-api=false, port=ISDYNABRMsg
      enable-take-address=false, indirect-api=false, port=ISDYNABRMsgDLCError
      enable-take-address=false, indirect-api=false, port=ISDYNABRMsgRxTime
      enable-take-address=false, indirect-api=false, port=ISDYNCMM208MsgDLCError
      enable-take-address=false, indirect-api=false, port=ISDYNCMM208MsgRxTime
      enable-take-address=false, indirect-api=false, port=ISDYNCMM388MsgDLCError
      enable-take-address=false, indirect-api=false, port=ISDYNCMM388MsgRxTime
      enable-take-address=false, indirect-api=false, port=ISDYNDAEFirstMessageSent
      enable-take-address=false, indirect-api=false, port=ISDYNVOLMsg
      enable-take-address=false, indirect-api=false, port=ISDYNVOLMsgDLCError
      enable-take-address=false, indirect-api=false, port=ISDYNVOLMsgRxTime
      enable-take-address=false, indirect-api=false, port=ISINTEELECTRONBSIMsgRxTime
      enable-take-address=false, indirect-api=false, port=JourEcoule
      enable-take-address=false, indirect-api=false, port=Kilometrage
      enable-take-address=false, indirect-api=false, port=LKAState
      enable-take-address=false, indirect-api=false, port=LKATrqFactReq
      enable-take-address=false, indirect-api=false, port=LXAActivation
      enable-take-address=false, indirect-api=false, port=LXASelected
      enable-take-address=false, indirect-api=false, port=MarcheARBVM
      enable-take-address=false, indirect-api=false, port=ModeDiag
      enable-take-address=false, indirect-api=false, port=NxtrDiagMgr
      enable-take-address=false, indirect-api=false, port=PowerSupplies
      enable-take-address=false, indirect-api=false, port=SecondeEcoulee
      enable-take-address=false, indirect-api=false, port=ShuntPosition
      enable-take-address=false, indirect-api=false, port=SrlComDriver_SCom
      enable-take-address=false, indirect-api=false, port=STATUSCONFABSENT
      enable-take-address=false, indirect-api=false, port=STTdSelected
      enable-take-address=false, indirect-api=false, port=SystemState
      enable-take-address=false, indirect-api=false, port=SystemTime
      enable-take-address=false, indirect-api=false, port=TMFTestComplete
      enable-take-address=false, indirect-api=false, port=TxEnabled
      enable-take-address=false, indirect-api=false, port=VITESSECOLONNE
      enable-take-address=false, indirect-api=false, port=VitesseVehicleBV
    7 x runnable:
      SrlComDriver_Init1
        sync call SC_SystemTime_GetSystemTime_mS_u32: operation=SystemTime.GetSystemTime_mS_u32, timeout=0
      SrlComDriver_Per1
        20 x data read access:
          READ_ANGLECOLONNE_Cnt_u16: data-element=ANGLECOLONNE.Cnt_u16
          READ_AUTORARRETMOTDA_Cnt_u08: data-element=AUTORARRETMOTDA.Cnt_u08
          READ_CAUSEDESACTIVCPK_Cnt_u08: data-element=CAUSEDESACTIVCPK.Cnt_u08
          READ_CODEDEFAUT_Cnt_u08: data-element=CODEDEFAUT.Cnt_u08
          READ_CPLEVOLANT_Cnt_u08: data-element=CPLEVOLANT.Cnt_u08
          READ_CPLEVOLANTOPTMSE_Cnt_u08: data-element=CPLEVOLANTOPTMSE.Cnt_u08
          READ_DDEREDEMDA_Cnt_u08: data-element=DDEREDEMDA.Cnt_u08
          READ_ElectronicIntegration_Cnt_lgc: data-element=ElectronicIntegration.Cnt_lgc
          READ_ETATASSISTDA_Cnt_u08: data-element=ETATASSISTDA.Cnt_u08
          READ_ETATDA2004_Cnt_u08: data-element=ETATDA2004.Cnt_u08
          READ_ETATDA2010_Cnt_u08: data-element=ETATDA2010.Cnt_u08
          READ_ETATDADYN_Cnt_u08: data-element=ETATDADYN.Cnt_u08
          READ_ETATDAECPK_Cnt_u08: data-element=ETATDAECPK.Cnt_u08
          READ_ETATLIGNEAPC_Cnt_u08: data-element=ETATLIGNEAPC.Cnt_u08
          READ_ETATSECUANGLECOL_Cnt_u08: data-element=ETATSECUANGLECOL.Cnt_u08
          READ_LXASelected_Cnt_lgc: data-element=LXASelected.Cnt_lgc
          READ_STATUSCONFABSENT_Cnt_u32: data-element=STATUSCONFABSENT.Cnt_u32
          READ_STTdSelected_Cnt_lgc: data-element=STTdSelected.Cnt_lgc
          READ_TMFTestComplete_Cnt_lgc: data-element=TMFTestComplete.Cnt_lgc
          READ_VITESSECOLONNE_Cnt_u16: data-element=VITESSECOLONNE.Cnt_u16
        51 x data write access:
          WRITE_AnneeEcoule_Cnt_u08: data-element=AnneeEcoule.Cnt_u08
          WRITE_BusOff_Cnt_lgc: data-element=BusOff.Cnt_lgc
          WRITE_ColumnAngleSetpoint_Cnt_u16: data-element=ColumnAngleSetpoint.Cnt_u16
          WRITE_CompteurTemporelVehicule_Cnt_u32: data-element=CompteurTemporelVehicule.Cnt_u32
          WRITE_ComputerRazGCT_Cnt_u08: data-element=ComputerRazGCT.Cnt_u08
          WRITE_DiagIntegraElec_Cnt_u08: data-element=DiagIntegraElec.Cnt_u08
          WRITE_DiagMuxOn_Cnt_u08: data-element=DiagMuxOn.Cnt_u08
          WRITE_DmdDelestDA_Cnt_u08: data-element=DmdDelestDA.Cnt_u08
          WRITE_EffacDefaultDiag_Cnt_u08: data-element=EffacDefaultDiag.Cnt_u08
          WRITE_EtatMT_Cnt_u08: data-element=EtatMT.Cnt_u08
          WRITE_EtatPrincipSev_Cnt_u08: data-element=EtatPrincipSev.Cnt_u08
          WRITE_EtatReseauElec_Cnt_u08: data-element=EtatReseauElec.Cnt_u08
          WRITE_ISDAT4V2BSI552MsgDLCError_Cnt_u08: data-element=ISDAT4V2BSI552MsgDLCError.Cnt_u08
          WRITE_ISDAT4V2BSI552MsgRxTime_MSec_u32: data-element=ISDAT4V2BSI552MsgRxTime.MSec_u32
          WRITE_ISDATBSI3F2MsgDLCError_Cnt_u08: data-element=ISDATBSI3F2MsgDLCError.Cnt_u08
          WRITE_ISDATBSI3F2MsgRxTime_MSec_u32: data-element=ISDATBSI3F2MsgRxTime.MSec_u32
          WRITE_ISDATBSI412MsgDLCError_Cnt_u08: data-element=ISDATBSI412MsgDLCError.Cnt_u08
          WRITE_ISDATBSI412MsgRxTime_MSec_u32: data-element=ISDATBSI412MsgRxTime.MSec_u32
          WRITE_ISDATBSI432MsgDLCError_Cnt_u08: data-element=ISDATBSI432MsgDLCError.Cnt_u08
          WRITE_ISDATBSI432MsgRxTime_MSec_u32: data-element=ISDATBSI432MsgRxTime.MSec_u32
          WRITE_ISDATDIRAMsgTxInProgress_Cnt_lgc: data-element=ISDATDIRAMsgTxInProgress.Cnt_lgc
          WRITE_ISDATDIRAMsgTxTime_MSec_u32: data-element=ISDATDIRAMsgTxTime.MSec_u32
          WRITE_ISDYN2CMMMsgDLCError_Cnt_u08: data-element=ISDYN2CMMMsgDLCError.Cnt_u08
          WRITE_ISDYN2CMMMsgRxTime_MSec_u32: data-element=ISDYN2CMMMsgRxTime.MSec_u32
          WRITE_ISDYNAASMsg_Cnt_u08: data-element=ISDYNAASMsg.Cnt_u08
          WRITE_ISDYNAASMsgDLCError_Cnt_u08: data-element=ISDYNAASMsgDLCError.Cnt_u08
          WRITE_ISDYNAASMsgRxTime_MSec_u32: data-element=ISDYNAASMsgRxTime.MSec_u32
          WRITE_ISDYNABRMsg_Cnt_u08: data-element=ISDYNABRMsg.Cnt_u08
          WRITE_ISDYNABRMsgDLCError_Cnt_u08: data-element=ISDYNABRMsgDLCError.Cnt_u08
          WRITE_ISDYNABRMsgRxTime_MSec_u32: data-element=ISDYNABRMsgRxTime.MSec_u32
          WRITE_ISDYNCMM208MsgDLCError_Cnt_u08: data-element=ISDYNCMM208MsgDLCError.Cnt_u08
          WRITE_ISDYNCMM208MsgRxTime_MSec_u32: data-element=ISDYNCMM208MsgRxTime.MSec_u32
          WRITE_ISDYNCMM388MsgDLCError_Cnt_u08: data-element=ISDYNCMM388MsgDLCError.Cnt_u08
          WRITE_ISDYNCMM388MsgRxTime_MSec_u32: data-element=ISDYNCMM388MsgRxTime.MSec_u32
          WRITE_ISDYNDAEFirstMessageSent_Cnt_lgc: data-element=ISDYNDAEFirstMessageSent.Cnt_lgc
          WRITE_ISDYNVOLMsg_Cnt_u08: data-element=ISDYNVOLMsg.Cnt_u08
          WRITE_ISDYNVOLMsgDLCError_Cnt_u08: data-element=ISDYNVOLMsgDLCError.Cnt_u08
          WRITE_ISDYNVOLMsgRxTime_MSec_u32: data-element=ISDYNVOLMsgRxTime.MSec_u32
          WRITE_ISINTEELECTRONBSIMsgRxTime_MSec_u32: data-element=ISINTEELECTRONBSIMsgRxTime.MSec_u32
          WRITE_JourEcoule_Cnt_u16: data-element=JourEcoule.Cnt_u16
          WRITE_Kilometrage_Cnt_u32: data-element=Kilometrage.Cnt_u32
          WRITE_LKAState_Cnt_u08: data-element=LKAState.Cnt_u08
          WRITE_LKATrqFactReq_Cnt_u08: data-element=LKATrqFactReq.Cnt_u08
          WRITE_LXAActivation_Cnt_u08: data-element=LXAActivation.Cnt_u08
          WRITE_MarcheARBVM_Cnt_u08: data-element=MarcheARBVM.Cnt_u08
          WRITE_ModeDiag_Cnt_u08: data-element=ModeDiag.Cnt_u08
          WRITE_PowerSupplies_Cnt_u08: data-element=PowerSupplies.Cnt_u08
          WRITE_SecondeEcoulee_Cnt_u32: data-element=SecondeEcoulee.Cnt_u32
          WRITE_ShuntPosition_Cnt_u08: data-element=ShuntPosition.Cnt_u08
          WRITE_TxEnabled_Cnt_lgc: data-element=TxEnabled.Cnt_lgc
          WRITE_VitesseVehicleBV_Cnt_u16: data-element=VitesseVehicleBV.Cnt_u16
        sync call SC_NxtrDiagMgr_SetNTCStatus: operation=NxtrDiagMgr.SetNTCStatus, timeout=0
        sync call SC_SystemTime_DtrmnElapsedTime_mS_u16: operation=SystemTime.DtrmnElapsedTime_mS_u16, timeout=0
        sync call SC_SystemTime_GetSystemTime_mS_u32: operation=SystemTime.GetSystemTime_mS_u32, timeout=0
      SrlComDriver_SCom_ElecIntStart
      SrlComDriver_SCom_ElecIntStop
      SrlComDriver_SCom_GetBusOffCounter
      SrlComDriver_Trns1
      SrlComDriver_Trns2
  swc implementation Cd_SrlComDriver_Implementation: behavior=Cd_SrlComDriver_InternalBehavior
    code-descriptors:
      code Code: type=SRC
